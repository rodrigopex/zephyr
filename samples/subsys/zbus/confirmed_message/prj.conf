## CMakeLists.txt
```
# SPDX-License-Identifier: Apache-2.0
cmake_minimum_required(VERSION 3.20.0)

find_package(Zephyr REQUIRED HINTS $ENV{ZEPHYR_BASE})
project(confirmed_message)

FILE(GLOB app_sources src/*.c)
target_sources(app PRIVATE ${app_sources})
```

## sample.yaml
```
sample:
  name: Confirmed messages
tests:
  sample.zbus.confirmed_messages:
    harness: console
    harness_config:
      type: multi_line
      ordered: false
      regex:
        - "I:  *** USB sending message sequence 0 to interested tasks (on-to-many) ***"
        - "I:  *** USB sending message sequence 1 to interested tasks (on-to-many) ***"
        - "I:  *** USB sending message sequence 2 to interested tasks (on-to-many) ***"
        - "I:  *** USB sending message sequence 3 to interested tasks (on-to-many) ***"
        - "I:  *** USB sending message sequence 4 to interested tasks (on-to-many) ***"
        - "I:  *** USB sending message sequence 5 to interested tasks (on-to-many) ***"
        - "I:  *** USB sending message sequence 6 to interested tasks (on-to-many) ***"
        - "I:  *** USB sending message sequence 7 to interested tasks (on-to-many) ***"
        - "I:  *** USB sending message sequence 8 to interested tasks (on-to-many) ***"
        - "I:  *** USB sending message sequence 9 to interested tasks (on-to-many) ***"
        - "I: Sample finished with success. 10 confirmed messages sent and confirmed"
    platform_exclude: qemu_leon3
    tags: zbus
```

## prj.conf
```kconfig
CONFIG_LOG=y
CONFIG_LOG_MODE_MINIMAL=y
CONFIG_BOOT_BANNER=n
CONFIG_MAIN_THREAD_PRIORITY=0
CONFIG_ASSERT=y
CONFIG_ZBUS=y
CONFIG_ZBUS_LOG_LEVEL_INF=y
CONFIG_ZBUS_CHANNEL_NAME=y
CONFIG_ZBUS_OBSERVER_NAME=y

CONFIG_ZBUS_RUNTIME_OBSERVERS_POOL_SIZE=8
```

## src/main.c
```c
/*
 * Copyright (c) 2022 Rodrigo Peixoto <rodrigopex@gmail.com>
 * SPDX-License-Identifier: Apache-2.0
 */

#include "messages.h"

#include <zephyr/kernel.h>
#include <zephyr/logging/log.h>
#include <zephyr/zbus/zbus.h>
LOG_MODULE_DECLARE(zbus, CONFIG_ZBUS_LOG_LEVEL);

bool internal_chan_validator(const void *msg, size_t msg_size)
{
	ARG_UNUSED(msg_size);

	const struct payload_msg *p = msg;

	if (p->sequence >= 0) {
		return true;
	}

	return false;
}

ZBUS_CHAN_DEFINE(internal_chan,  /* Name */
		 false,		     /* Read only */
		 struct payload_msg, /* Message type */

		 internal_chan_validator, /* Validator */
		 ZBUS_OBSERVERS_EMPTY,	      /* observers */
		 ZBUS_MSG_INIT(0)	      /* Initial value */
);

ZBUS_CHAN_DEFINE(internal_ack_chan, /* Name */
		 false,			/* Read only */
		 struct ack_msg,	/* Message type */

		 NULL,				   /* Validator */
		 ZBUS_OBSERVERS(internal_ack_lis), /* observers */
		 ZBUS_MSG_INIT(0)		   /* Initial value */
);

K_SEM_DEFINE(internal_chan_sem, 1, 1);

static struct payload_msg global_payload;

static uint8_t global_ack_ids;

static void internal_ack_listener_cb(const struct zbus_channel *chan)
{
	const struct ack_msg *am = zbus_chan_const_msg(chan);

	__ASSERT(am->sequence == global_payload.sequence,
		 "Sequence must be the same. Found left = %d and right = %d", am->sequence,
		 global_payload.sequence);

	LOG_INF("----------------------------------");
	LOG_INF("Critical %d sent ACK!", am->id + 1);

	WRITE_BIT(global_ack_ids, am->id, 1);

	if (global_ack_ids == 0b00011111) {
		global_ack_ids = 0;

		++global_payload.sequence;

		k_sem_give(&internal_chan_sem);
	}
}

ZBUS_LISTENER_DEFINE(internal_ack_lis, internal_ack_listener_cb);

ZBUS_OBS_DECLARE(critical1_sub, critical2_sub, critical3_sub, critical4_sub, critical5_sub);

void main(void)
{
	memset(global_payload.data, 0, ARRAY_SIZE(global_payload.data));
	global_ack_ids = 0;

	zbus_chan_add_obs(&internal_chan, &critical1_sub, K_MSEC(100));
	zbus_chan_add_obs(&internal_chan, &critical2_sub, K_MSEC(100));
	zbus_chan_add_obs(&internal_chan, &critical3_sub, K_MSEC(100));
	zbus_chan_add_obs(&internal_chan, &critical4_sub, K_MSEC(100));
	zbus_chan_add_obs(&internal_chan, &critical5_sub, K_MSEC(100));

	for (int i = 0; i < 10; ++i) {
		global_payload.data[i] = i;

		if (!k_sem_take(&internal_chan_sem, K_FOREVER)) {
			LOG_INF("----------------------------------");
			LOG_INF(" *** USB sending message sequence %d to interested tasks "
				"(on-to-many) *** ",
				global_payload.sequence);

			zbus_chan_pub(&internal_chan, &global_payload, K_SECONDS(1));
		}
	}

	if (!k_sem_take(&internal_chan_sem, K_FOREVER)) {
		LOG_INF("Sample finished with success. %d "
			"confirmed messages sent and confirmed",
			global_payload.sequence);
	}
}
```

## src/critical_subscribers.c
```c
/*
 * Copyright (c) 2022 Rodrigo Peixoto <rodrigopex@gmail.com>
 * SPDX-License-Identifier: Apache-2.0
 */
#include "messages.h"

#include <zephyr/kernel.h>
#include <zephyr/logging/log.h>
#include <zephyr/zbus/zbus.h>

LOG_MODULE_DECLARE(zbus, CONFIG_ZBUS_LOG_LEVEL);

ZBUS_CHAN_DECLARE(internal_chan, internal_ack_chan);

ZBUS_SUBSCRIBER_DEFINE(critical1_sub, 4);

ZBUS_SUBSCRIBER_DEFINE(critical2_sub, 4);

ZBUS_SUBSCRIBER_DEFINE(critical3_sub, 4);

ZBUS_SUBSCRIBER_DEFINE(critical4_sub, 4);

ZBUS_SUBSCRIBER_DEFINE(critical5_sub, 4);

static void sub_task(void *sub, void *id)
{
	struct zbus_channel *chan;
	struct payload_msg local_payload;
	struct zbus_observer *subscriber = sub;
	enum critical_sub_id *sub_id = id;

	while (!zbus_sub_wait(subscriber, &chan, K_FOREVER)) {
		if (chan == &internal_chan) {
			int err = zbus_chan_read(&internal_chan, &local_payload, K_MSEC(300));
			__ASSERT(!err, "Channel must be read");

			LOG_INF("----------------------------------");
			LOG_INF("%s received sequence: %d", subscriber->name,
				local_payload.sequence);
			LOG_HEXDUMP_INF(local_payload.data, ARRAY_SIZE(local_payload.data),
					"Data:");

			struct ack_msg am = {.sequence = local_payload.sequence, .id = *sub_id};

			zbus_chan_pub(&internal_ack_chan, &am, K_MSEC(100));
		}
	}
}
enum critical_sub_id critical1_id = CRITICAL1;
K_THREAD_DEFINE(subscriber1_task_id, 512, sub_task, &critical1_sub, &critical1_id, NULL, 3, 0, 0);

enum critical_sub_id critical2_id = CRITICAL2;
K_THREAD_DEFINE(subscriber2_task_id, 512, sub_task, &critical2_sub, &critical2_id, NULL, 3, 0, 0);

enum critical_sub_id critical3_id = CRITICAL3;
K_THREAD_DEFINE(subscriber3_task_id, 512, sub_task, &critical3_sub, &critical3_id, NULL, 3, 0, 0);

enum critical_sub_id critical4_id = CRITICAL4;
K_THREAD_DEFINE(subscriber4_task_id, 512, sub_task, &critical4_sub, &critical4_id, NULL, 3, 0, 0);

enum critical_sub_id critical5_id = CRITICAL5;
K_THREAD_DEFINE(subscriber5_task_id, 512, sub_task, &critical5_sub, &critical5_id, NULL, 3, 0, 0);
```

## src/messages.h
```c
/*
 * Copyright (c) 2022 Rodrigo Peixoto <rodrigopex@gmail.com>
 * SPDX-License-Identifier: Apache-2.0
 */
#ifndef MESSAGES_H
#define MESSAGES_H
#include <stdint.h>

#include <zephyr/kernel.h>

struct payload_msg {
	int sequence;
	uint8_t data[16];
};

enum critical_sub_id {
	CRITICAL1,
	CRITICAL2,
	CRITICAL3,
	CRITICAL4,
	CRITICAL5,
};

struct ack_msg {
	uint8_t sequence;
	enum critical_sub_id id;
};
#endif /* MESSAGES_H */
```
