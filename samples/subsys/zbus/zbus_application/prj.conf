## CMakeLists.txt
```
# SPDX-License-Identifier: Apache-2.0
cmake_minimum_required(VERSION 3.20.0)

find_package(Zephyr REQUIRED HINTS $ENV{ZEPHYR_BASE})
project(runtime_obs_registration)

include_directories(${CMAKE_CURRENT_SOURCE_DIR}/include)

file(GLOB app_sources src/*.c)
target_sources(app PRIVATE ${app_sources})
```

## Kconfig
```
# Copyright (c) 2022 Rodrigo Peixoto <rodrigopex@gmail.com>
# SPDX-License-Identifier: Apache-2.0

config CORE_SCOPE
	bool "Use core scope on the firmware"
	default y

source "Kconfig.zephyr"
```

## prj.conf
```kconfig
CONFIG_LOG=y
CONFIG_LOG_MODE_MINIMAL=y
CONFIG_THREAD_NAME=y
CONFIG_SHELL=y

CONFIG_SERIAL=y
CONFIG_UART_LINE_CTRL=n

CONFIG_ZBUS=y
CONFIG_ZBUS_MSG_SUBSCRIBER=y
CONFIG_ZBUS_LOG_LEVEL_INF=y
CONFIG_ZBUS_CHANNEL_NAME=y


CONFIG_HEAP_MEM_POOL_SIZE=1024
CONFIG_TEST_RANDOM_GENERATOR=y
```

## include/calculator_iface.h
```c
/*
 * Copyright (c) 2023 Rodrigo Peixoto <rodrigopex@gmail.com>
 * SPDX-License-Identifier: Apache-2.0
 */
#ifndef _CALCULATOR_IFACE_H_
#define _CALCULATOR_IFACE_H_

#include "zephyr/zbus/zbus.h"

struct msg_calculator__command {
	char op;
	int param1;
	int param2;
};

ZBUS_CHAN_DECLARE(chan_calculator_in__command);

struct msg_calculator__command_result {
	int result;
	int return_code;
};

ZBUS_CHAN_DECLARE(chan_calculator_out__command_result);

#endif /* _CALCULATOR_IFACE_H_ */
```

## include/calculator_scope.h
```c
/*
 * Copyright (c) 2023 Rodrigo Peixoto <rodrigopex@gmail.com>
 * SPDX-License-Identifier: Apache-2.0
 */
#ifndef _CALCULATOR_SCOPE_H_
#define _CALCULATOR_SCOPE_H_

#include "zephyr/zbus/zbus.h"

struct msg_calculator__command {
	char op;
	int param1;
	int param2;
};

ZBUS_CHAN_DECLARE(chan_calculator_in__command);

struct msg_calculator__command_result {
	int result;
	int return_code;
};

ZBUS_CHAN_DECLARE(chan_calculator_out__command_result);

#endif /* _CALCULATOR_SCOPE_H_ */
```

## include/net_iface.h
```c
/*
 * Copyright (c) 2023 Rodrigo Peixoto <rodrigopex@gmail.com>
 * SPDX-License-Identifier: Apache-2.0
 */
#ifndef _NET_IFACE_H_
#define _NET_IFACE_H_

#include <zephyr/zbus/zbus.h>

struct msg_net__transmission_result {
	int return_code;
};

ZBUS_CHAN_DECLARE(chan_net_out__transmission_done);

#endif /* _NET_IFACE_H_ */
```

## include/net_scope.h
```c
/*
 * Copyright (c) 2023 Rodrigo Peixoto <rodrigopex@gmail.com>
 * SPDX-License-Identifier: Apache-2.0
 */
#ifndef _NET_SCOPE_H_
#define _NET_SCOPE_H_

#include <zephyr/zbus/zbus.h>

struct msg_net__transmission_result {
	int return_code;
};

ZBUS_CHAN_DECLARE(chan_net_out__transmission_done);

#endif /* _NET_SCOPE_H_ */
```

## src/calculator_iface.c
```c
/*
 * Copyright (c) 2022 Rodrigo Peixoto <rodrigopex@gmail.com>
 * SPDX-License-Identifier: Apache-2.0
 */
#include "calculator_iface.h"
#include <zephyr/kernel.h>
#include <zephyr/zbus/zbus.h>

ZBUS_CHAN_DEFINE(chan_calculator_in__command, struct msg_calculator__command, NULL, NULL,
		 ZBUS_OBSERVERS_EMPTY, ZBUS_MSG_INIT(0));

ZBUS_CHAN_DEFINE(chan_calculator_out__command_result, struct msg_calculator__command_result, NULL,
		 NULL, ZBUS_OBSERVERS_EMPTY, ZBUS_MSG_INIT(0));
```

## src/calculator_impl.c
```c
/*
 * Copyright (c) 2023 Rodrigo Peixoto <rodrigopex@gmail.com>
 * SPDX-License-Identifier: Apache-2.0
 */
#include "calculator_iface.h"
#include <stdio.h>
#include <zephyr/kernel.h>
#include <zephyr/zbus/zbus.h>

ZBUS_MSG_SUBSCRIBER_DEFINE(msub_calculator);

ZBUS_CHAN_ADD_OBS(chan_calculator_in__command, msub_calculator, 3);

void __calculator_command_executor(const struct msg_calculator__command *cmd,
				   struct msg_calculator__command_result *cmd_res)
{
	cmd_res->result = 0;
	cmd_res->return_code = 0;

	switch (cmd->op) {
	case '+':
		cmd_res->result = cmd->param1 + cmd->param2;
		break;
	case '-':
		cmd_res->result = cmd->param1 - cmd->param2;
		break;
	case '*':
		cmd_res->result = cmd->param1 * cmd->param2;
		break;
	case '/':
		if (cmd->param2 == 0) {
			cmd_res->return_code = -EFAULT;
		} else {
			cmd_res->result = cmd->param1 / cmd->param2;
		}
		break;
	default:
		cmd_res->return_code = -EINVAL;
	}
}

static void calculator_thread(void)
{
	const struct zbus_channel *chan;
	struct msg_calculator__command cmd = {0};

	while (1) {
		if (zbus_sub_wait_msg(&msub_calculator, &chan, &cmd, K_FOREVER)) {
			k_oops();
		}

		struct msg_calculator__command_result cmd_res;

		__calculator_command_executor(&cmd, &cmd_res);

		zbus_chan_pub(&chan_calculator_out__command_result, &cmd_res, K_FOREVER);
	}
}

K_THREAD_DEFINE(calculator_thread_id, 1024, calculator_thread, NULL, NULL, NULL, 3, 0, 0);
```

## src/calculator_scope.c
```c
/*
 * Copyright (c) 2022 Rodrigo Peixoto <rodrigopex@gmail.com>
 * SPDX-License-Identifier: Apache-2.0
 */
#include "calculator_scope.h"
#include <zephyr/kernel.h>
#include <zephyr/zbus/zbus.h>

ZBUS_CHAN_DEFINE(chan_calculator_in__command, struct msg_calculator__command, NULL, NULL,
		 ZBUS_OBSERVERS_EMPTY, ZBUS_MSG_INIT(0));

ZBUS_CHAN_DEFINE(chan_calculator_out__command_result, struct msg_calculator__command_result, NULL,
		 NULL, ZBUS_OBSERVERS_EMPTY, ZBUS_MSG_INIT(0));
```

## src/calculator_scope_impl.c
```c
/*
 * Copyright (c) 2023 Rodrigo Peixoto <rodrigopex@gmail.com>
 * SPDX-License-Identifier: Apache-2.0
 */
#include "calculator_scope.h"
#include "zephyr/sys/printk.h"
#include <stdio.h>
#include <zephyr/kernel.h>
#include <zephyr/zbus/zbus.h>

ZBUS_MSG_SUBSCRIBER_DEFINE(msub_calculator);

ZBUS_CHAN_ADD_OBS(chan_calculator_in__command, msub_calculator, 3);

void __calculator_command_executor(const struct msg_calculator__command *cmd,
				   struct msg_calculator__command_result *cmd_res)
{
	cmd_res->result = 0;
	cmd_res->return_code = 0;

	switch (cmd->op) {
	case '+':
		cmd_res->result = cmd->param1 + cmd->param2;
		break;
	case '-':
		cmd_res->result = cmd->param1 - cmd->param2;
		break;
	case '*':
		cmd_res->result = cmd->param1 * cmd->param2;
		break;
	case '/':
		if (cmd->param2 == 0) {
			cmd_res->return_code = -EFAULT;
		} else {
			cmd_res->result = cmd->param1 / cmd->param2;
		}
		break;
	default:
		cmd_res->return_code = -EINVAL;
	}
}

static void calculator_thread(void)
{
	const struct zbus_channel *chan;
	struct msg_calculator__command cmd = {0};

	while (1) {
		if (zbus_sub_wait_msg(&msub_calculator, &chan, &cmd, K_FOREVER)) {
			k_oops();
		}

		struct msg_calculator__command_result cmd_res;

		__calculator_command_executor(&cmd, &cmd_res);

		zbus_chan_pub(&chan_calculator_out__command_result, &cmd_res, K_FOREVER);
	}
}

K_THREAD_DEFINE(calculator_thread_id, 1024, calculator_thread, NULL, NULL, NULL, 3, 0, 0);
```

## src/io.c
```c
/*
 * Copyright (c) 2023 Rodrigo Peixoto <rodrigopex@gmail.com>
 * SPDX-License-Identifier: Apache-2.0
 */
#include "calculator_iface.h"
#include <zephyr/kernel.h>
#include <zephyr/zbus/zbus.h>
#include <zephyr/random/random.h>
#include <zephyr/shell/shell.h>

ZBUS_MSG_SUBSCRIBER_DEFINE(msub_io_calculator__command_result);

ZBUS_CHAN_ADD_OBS(chan_calculator_out__command_result, msub_io_calculator__command_result, 1);

static int cmd_eval(const struct shell *sh, size_t argc, char **argv)
{
	int err;
	const struct zbus_channel *chan;
	struct msg_calculator__command_result cmd_res;

	struct msg_calculator__command cmd = {
		.op = argv[2][0], .param1 = atoi(argv[1]), .param2 = atoi(argv[3])};

	err = zbus_chan_pub(&chan_calculator_in__command, &cmd, K_FOREVER);
	if (err) {
		return err;
	}

	err = zbus_sub_wait_msg(&msub_io_calculator__command_result, &chan, &cmd_res, K_MSEC(500));
	if (err) {
		return err;
	}

	shell_print(sh, "%d %c %d = %d", cmd.param1, cmd.op, cmd.param2, cmd_res.result);

	return 0;
}

SHELL_CMD_ARG_REGISTER(eval, NULL, "Calculator command", cmd_eval, 4, 0);
```

## src/net_iface.c
```c
/*
 * Copyright (c) 2023 Rodrigo Peixoto <rodrigopex@gmail.com>
 * SPDX-License-Identifier: Apache-2.0
 */
#include "net_iface.h"
#include <zephyr/kernel.h>
#include <zephyr/zbus/zbus.h>

ZBUS_CHAN_DEFINE(chan_net_out__transmission_done, struct msg_net__transmission_result, NULL, NULL,
		 ZBUS_OBSERVERS_EMPTY, ZBUS_MSG_INIT(0));
```

## src/net_impl.c
```c
/*
 * Copyright (c) 2023 Rodrigo Peixoto <rodrigopex@gmail.com>
 * SPDX-License-Identifier: Apache-2.0
 */
#include "calculator_iface.h"
#include "net_iface.h"
#include <zephyr/kernel.h>
#include <zephyr/zbus/zbus.h>

ZBUS_MSG_SUBSCRIBER_DEFINE(msub_net);

ZBUS_CHAN_ADD_OBS(chan_calculator_out__command_result, msub_net, 3);

static void net_thread(void)
{
	int err;
	const struct zbus_channel *chan;
	struct msg_calculator__command_result calc_res;
	struct msg_net__transmission_result trans_res;

	while (1) {
		if (zbus_sub_wait_msg(&msub_net, &chan, &calc_res, K_FOREVER)) {
			k_oops();
		}

		if (calc_res.return_code) {
			err = calc_res.return_code;
			printk("ERR(%d)\n", calc_res.return_code);
		} else {
			err = 0;
			printk("%d\n", calc_res.result);
		}

		trans_res.return_code = err;

		zbus_chan_pub(&chan_net_out__transmission_done, &trans_res, K_FOREVER);
	}
}

K_THREAD_DEFINE(net_thread_id, 1024, net_thread, NULL, NULL, NULL, 3, 0, 0);
```

## src/net_scope.c
```c
/*
 * Copyright (c) 2023 Rodrigo Peixoto <rodrigopex@gmail.com>
 * SPDX-License-Identifier: Apache-2.0
 */
#include "net_scope.h"
#include <zephyr/kernel.h>
#include <zephyr/zbus/zbus.h>

ZBUS_CHAN_DEFINE(chan_net_out__transmission_done, struct msg_net__transmission_result, NULL, NULL,
		 ZBUS_OBSERVERS_EMPTY, ZBUS_MSG_INIT(0));
```
