## CMakeLists.txt
```
# SPDX-License-Identifier: Apache-2.0
cmake_minimum_required(VERSION 3.20.0)

find_package(Zephyr REQUIRED HINTS $ENV{ZEPHYR_BASE})
project(calculator)

include_directories(${CMAKE_CURRENT_SOURCE_DIR}/../../include)

target_sources(
  app
  PRIVATE "${CMAKE_CURRENT_SOURCE_DIR}/src/main.c"
          "${CMAKE_CURRENT_SOURCE_DIR}/../../src/calculator_iface.c"
          "${CMAKE_CURRENT_SOURCE_DIR}/../../src/calculator_impl.c")
```

## prj.conf
```kconfig
CONFIG_ZTEST=y
CONFIG_ASSERT=y
CONFIG_LOG=y
CONFIG_ZBUS=y
CONFIG_ZBUS_LOG_LEVEL_INF=y
CONFIG_ZBUS_ASSERT_MOCK=y
CONFIG_IRQ_OFFLOAD=y
CONFIG_ZBUS_MSG_SUBSCRIBER=y
CONFIG_ZBUS_MSG_SUBSCRIBER_NET_BUF_POOL_SIZE=16
CONFIG_ZBUS_RUNTIME_OBSERVERS=y
CONFIG_HEAP_MEM_POOL_SIZE=1024
CONFIG_TEST_RANDOM_GENERATOR=y
CONFIG_ZBUS_CHANNEL_NAME=y
CONFIG_ZBUS_OBSERVER_NAME=y
```

## src/main.c
```c
/*
 * Copyright (c) 2022 Rodrigo Peixoto <rodrigopex@gmail.com>
 * SPDX-License-Identifier: Apache-2.0
 */

#include "calculator_iface.h"

#include <zephyr/kernel.h>
#include <zephyr/zbus/zbus.h>
#include <zephyr/ztest.h>
#include <zephyr/random/random.h>

ZBUS_MSG_SUBSCRIBER_DEFINE(msub_calculator_command_result);

ZBUS_CHAN_ADD_OBS(chan_calculator_out__command_result, msub_calculator_command_result, 3);

#define ITERATION_COUNT 5000

ZTEST(calculator, test_sum_sub_mul)
{
	int expected_result;

	const struct zbus_channel *chan;
	struct msg_calculator__command_result cmd_res = {0};
	char *ops = (char[]){'+', '-', '*'};
	char *end = ops + 3;
	for (; ops < end; ++ops) {
		for (int i = 0; i < ITERATION_COUNT; ++i) {

			struct msg_calculator__command cmd = {
				.op = *ops, .param1 = sys_rand32_get(), .param2 = sys_rand32_get()};

			expected_result = cmd.op == '+'
						  ? cmd.param1 + cmd.param2
						  : (cmd.op == '-' ? (cmd.param1 - cmd.param2)
								   : (cmd.param1 * cmd.param2));

			zassert_true(0 ==
				     zbus_chan_pub(&chan_calculator_in__command, &cmd, K_FOREVER));

			zassert_true(0 == zbus_sub_wait_msg(&msub_calculator_command_result, &chan,
							    &cmd_res, K_FOREVER));

			zassert_true(0 == cmd_res.return_code);

			zassert_true(expected_result == cmd_res.result, "%d %c %d = (%d == %d)",
				     cmd.param1, cmd.op, cmd.param2, expected_result,
				     cmd_res.result);
		}
	}
}

ZTEST(calculator, test_div)
{
	int expected_result;
	const struct zbus_channel *chan;
	struct msg_calculator__command_result cmd_res;

	/*Division by zero */
	struct msg_calculator__command cmd = {.op = '/', .param1 = sys_rand32_get(), .param2 = 0};

	zassert_true(0 == zbus_chan_pub(&chan_calculator_in__command, &cmd, K_FOREVER));

	zassert_true(0 == zbus_sub_wait_msg(&msub_calculator_command_result, &chan, &cmd_res,
					    K_FOREVER));

	zassert_true(-EFAULT == cmd_res.return_code);

	/* Random numbers */
	for (int i = 0; i < ITERATION_COUNT; ++i) {

		struct msg_calculator__command cmd = {
			.op = '/', .param1 = sys_rand32_get(), .param2 = sys_rand32_get()};

		zassert_true(0 == zbus_chan_pub(&chan_calculator_in__command, &cmd, K_FOREVER));

		zassert_true(0 == zbus_sub_wait_msg(&msub_calculator_command_result, &chan,
						    &cmd_res, K_FOREVER));
		if (cmd.param2 == 0) {
			zassert_true(-EFAULT == cmd_res.return_code);
		} else {
			expected_result = cmd.param1 / cmd.param2;

			zassert_true(0 == cmd_res.return_code);

			zassert_true(expected_result == cmd_res.result);
		}
	}
}

ZTEST_SUITE(calculator, NULL, NULL, NULL, NULL, NULL);
```
