## samples/subsys/zbus/zbus_application/tests/calculator/testcase.yaml
```yaml
tests:
  zbus_application.calculator.test_sum_sub_mul_div:
    tags: zbus_application
    integration_platforms:
      - native_sim
```

## samples/subsys/zbus/zbus_application/tests/integration/testcase.yaml
```yaml
tests:
  zbus_application.integration.test_calculator_net:
    platform_allow: m2gl025_miv
    tags: zbus_application
    harness: robot
    harness_config:
      robot_test_path: integration.robot
    integration_platforms:
      - native_sim
```

## samples/subsys/zbus/zbus_application/tests/io/testcase.yaml
```yaml
tests:
  zbus_application.io.test_cmd_generation:
    platform_allow: m2gl025_miv
    tags: zbus_application
    integration_platforms:
      - native_sim
```

## samples/subsys/zbus/zbus_application/tests/net/testcase.yaml
```yaml
tests:
  zbus_application.net.test_transmission:
    tags: zbus_application
    integration_platforms:
      - native_sim
```

## subsys/zbus/Kconfig
```kconfig
# Copyright (c) 2022 Rodrigo Peixoto <rodrigopex@gmail.com>
# SPDX-License-Identifier: Apache-2.0

menuconfig ZBUS
	bool "Zbus support"
	help
	  Enables support for Zephyr message bus.

if ZBUS

config ZBUS_CHANNELS_SYS_INIT_PRIORITY
	default 5
	int "The priority used during the SYS_INIT procedure."

config ZBUS_MSG_SUBSCRIBER
	select NET_BUF
	depends on CONFIG_HEAP_MEM_POOL_SIZE > 256
	bool "Message subscribers will receive all messages in sequency."

if ZBUS_MSG_SUBSCRIBER

config ZBUS_MSG_SUBSCRIBER_NET_BUF_POOL_SIZE
	default 16
	int "The count of net_buf available to be used simutaneously."

endif # ZBUS_MSG_SUBSCRIBER

config ZBUS_STRUCTS_ITERABLE_ACCESS
	bool "Zbus iterable sections support."
	depends on !XTENSA
	default y

config ZBUS_CHANNEL_NAME
	bool "Channel name field"

config ZBUS_OBSERVER_NAME
	bool "Observer name field"

config ZBUS_RUNTIME_OBSERVERS_POOL_SIZE
	int "The size of the runtime observers pool."
	default 0
	help
	  When the size is bigger than zero this feature will be enabled. It applies the Object Pool Pattern,
	  where the objects in the pool are pre-allocated and can be used and recycled after use. The
	  technique avoids dynamic allocation and allows the code to increase the number of observers by
	  only changing a configuration.

config ZBUS_ASSERT_MOCK
	bool "Zbus assert mock for test purposes."
	help
	  This configuration enables the developer to change the _ZBUS_ASSERT behavior. When this configuration is
	  enabled, _ZBUS_ASSERT returns -EFAULT instead of assert. It makes it more straightforward to test invalid
	  parameters.


module = ZBUS
module-str = zbus
source "subsys/logging/Kconfig.template.log_config"

endif # ZBUS
```
