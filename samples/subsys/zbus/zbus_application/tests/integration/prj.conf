## CMakeLists.txt
```
# SPDX-License-Identifier: Apache-2.0
cmake_minimum_required(VERSION 3.20.0)

find_package(Zephyr REQUIRED HINTS $ENV{ZEPHYR_BASE})
project(calculator)

include_directories(${CMAKE_CURRENT_SOURCE_DIR}/../../include)

target_sources(
  app
  PRIVATE "${CMAKE_CURRENT_SOURCE_DIR}/../../src/calculator_iface.c"
          "${CMAKE_CURRENT_SOURCE_DIR}/../../src/calculator_impl.c"
          "${CMAKE_CURRENT_SOURCE_DIR}/../../src/io.c"
          "${CMAKE_CURRENT_SOURCE_DIR}/../../src/net_iface.c"
          "${CMAKE_CURRENT_SOURCE_DIR}/../../src/net_impl.c")
```

## prj.conf
```kconfig
CONFIG_SHELL=y
CONFIG_ASSERT=y
CONFIG_LOG=y
CONFIG_ZBUS=y
CONFIG_ZBUS_LOG_LEVEL_INF=y
CONFIG_ZBUS_MSG_SUBSCRIBER=y
CONFIG_ZBUS_MSG_SUBSCRIBER_NET_BUF_POOL_SIZE=16
CONFIG_ZBUS_RUNTIME_OBSERVERS=y
CONFIG_HEAP_MEM_POOL_SIZE=1024
CONFIG_TEST_RANDOM_GENERATOR=y
CONFIG_ZBUS_CHANNEL_NAME=y
CONFIG_ZBUS_OBSERVER_NAME=y
```

## src/io_mock.c
```c
/*
 * Copyright (c) 2023 Rodrigo Peixoto <rodrigopex@gmail.com>
 * SPDX-License-Identifier: Apache-2.0
 */
#include "calculator_iface.h"
#include <zephyr/kernel.h>
#include <zephyr/zbus/zbus.h>
#include <zephyr/random/random.h>

static void io_thread(void)
{
	const char ops[] = "+-*/";

	while (1) {
		struct msg_calculator__command cmd = {.op = ops[sys_rand32_get() % 4],
						      .param1 = sys_rand32_get() % 25,
						      .param2 = sys_rand32_get() % 25};

		printk("\n%d %c %d =", cmd.param1, cmd.op, cmd.param2);

		zbus_chan_pub(&chan_calculator_in__command, &cmd, K_FOREVER);

		k_msleep(1000);
	}
}

K_THREAD_DEFINE(io_thread_id, 1024, io_thread, NULL, NULL, NULL, 3, 0, 0);
```
