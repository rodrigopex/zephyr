## CMakeLists.txt
```
# SPDX-License-Identifier: Apache-2.0

cmake_minimum_required(VERSION 3.20.0)
find_package(Zephyr REQUIRED HINTS $ENV{ZEPHYR_BASE})
project(nano_service_arch)

include_directories(${CMAKE_CURRENT_SOURCE_DIR}/include)

include(zns/nano_services.cmake)
nano_service_register(app include/indicator.proto)
nano_service_register(app include/trigger.proto)

if(CONFIG_BUTTON_TRIGGER)
  target_sources(app PRIVATE src/button_trigger.c)
elseif(CONFIG_TIMER_TRIGGER)
  target_sources(app PRIVATE src/timer_trigger.c)
endif()

target_sources(app PRIVATE src/main.c src/led_indicator.c)
```

## Kconfig
```
# Copyright (c) 2024 Rodrigo Peixoto <rodrigopex@gmail.com>
# SPDX-License-Identifier: Apache-2.0

choice
	prompt "Trigger module implementation"
	optional

config TIMER_TRIGGER
	bool "The timer trigger will activate the trigger from time to time."

config BUTTON_TRIGGER
	bool "The button trigger will activate the trigger whenever the user presses the button."
	select GPIO

endchoice

module = APP
module-str = app
source "subsys/logging/Kconfig.template.log_config"

source "Kconfig.zephyr"
```

## prj.conf
```kconfig
CONFIG_LOG=y
CONFIG_APP_LOG_LEVEL_INF=y
CONFIG_ASSERT=y

CONFIG_ZBUS=y
CONFIG_ZBUS_CHANNEL_NAME=y
CONFIG_ZBUS_MSG_SUBSCRIBER=y
CONFIG_HEAP_MEM_POOL_SIZE=1024

CONFIG_SHELL_THREAD_PRIORITY=5
CONFIG_SHELL_THREAD_PRIORITY_OVERRIDE=y
```

## src/main.c
```c
#include <zephyr/zbus/zbus.h>

#include "nano_services/indicator.h"
#include "nano_services/trigger.h"

#include <zephyr/logging/log.h>

LOG_MODULE_REGISTER(app, CONFIG_APP_LOG_LEVEL);

ZBUS_MSG_SUBSCRIBER_DEFINE(msub_post);

ZBUS_CHAN_ADD_OBS(chan_indicator_evt, msub_post, 3);
ZBUS_CHAN_ADD_OBS(chan_trigger_evt, msub_post, 3);

int main(void)
{
	int system_status = 0;

	union {
		struct msg_trigger_evt trigger_evt;
		struct msg_indicator_evt indicator_evt;
	} msg;

	const struct zbus_channel *chan;

	while (1) {
		zbus_sub_wait_msg(&msub_post, &chan, &msg, K_FOREVER);

		if (chan == &chan_indicator_evt) {

			if (msg.indicator_evt.which_indicator_evt == MSG_INDICATOR_EVT_READY_TAG) {
				++system_status;

				LOG_INF("Indicator service...[ok]");
			} else {
				LOG_WRN("Indicator service...[failed: %d]",
					msg.indicator_evt.failed.error_code);
			}
		} else if (chan == &chan_trigger_evt) {

			if (msg.trigger_evt.which_trigger_evt == MSG_TRIGGER_EVT_READY_TAG) {
				++system_status;
				LOG_INF("Trigger service...[ok]");

			} else {
				LOG_WRN("Trigger service...[failed: %d]\n",
					msg.trigger_evt.failed.error_code);
			}
		}

		if (system_status == 2) {
			zbus_obs_set_enable(&msub_post, false);

			break;
		}
	}

	return 0;
}
```

## include/nano_services.h
```c
#include <zephyr/shell/shell.h>
#include <pb_decode.h>
#include <pb_encode.h>
#include <zephyr/shell/shell_backend.h>
#include <zephyr/sys/util.h>

#define NANO_SERVICE_SHELL_INIT()                                                                  \
	static const struct shell *sh_uart;                                                        \
	static int init_shell()                                                                    \
	{                                                                                          \
		sh_uart = shell_backend_get_by_name("shell_uart");                                 \
		return 0;                                                                          \
	}                                                                                          \
	SYS_INIT(init_shell, APPLICATION, 99)

#define NANO_SERVICE_RSP_DUMP(service, SERVICE)                                                    \
	static void dump_listener_callback_##service##_rsp(const struct zbus_channel *chan)        \
	{                                                                                          \
		uint8_t buffer[MSG_##SERVICE##_RSP_SIZE] = {0};                                    \
		pb_ostream_t stream = pb_ostream_from_buffer(buffer, MSG_##SERVICE##_RSP_SIZE);    \
		const struct msg_##service##_rsp *serv = zbus_chan_const_msg(chan);                \
		pb_encode(&stream, MSG_##SERVICE##_RSP_FIELDS, serv);                              \
		char data_string[MSG_##SERVICE##_RSP_SIZE * 2 + 1] = {0};                          \
		bin2hex(buffer, stream.bytes_written, data_string,                                 \
			MSG_##SERVICE##_RSP_SIZE * 2 + 1);                                         \
		shell_print(sh_uart, "@%s %s", zbus_chan_name(chan), data_string);                 \
	}                                                                                          \
	ZBUS_LISTENER_DEFINE(lis_dump_##service##_rsp, dump_listener_callback_##service##_rsp);    \
	ZBUS_CHAN_ADD_OBS(chan_##service##_rsp, lis_dump_##service##_rsp, 3)

#define NANO_SERVICE_EVT_DUMP(service, SERVICE)                                                    \
	static void dump_listener_callback_##service##_evt(const struct zbus_channel *chan)        \
	{                                                                                          \
		uint8_t buffer[MSG_##SERVICE##_EVT_SIZE] = {0};                                    \
		pb_ostream_t stream = pb_ostream_from_buffer(buffer, MSG_##SERVICE##_EVT_SIZE);    \
		const struct msg_##service##_evt *serv = zbus_chan_const_msg(chan);                \
		pb_encode(&stream, MSG_##SERVICE##_EVT_FIELDS, serv);                              \
		char data_string[MSG_##SERVICE##_EVT_SIZE * 2 + 1] = {0};                          \
		bin2hex(buffer, stream.bytes_written, data_string,                                 \
			MSG_##SERVICE##_EVT_SIZE * 2 + 1);                                         \
		printk("@%s %s\n", zbus_chan_name(chan), data_string);                             \
	}                                                                                          \
	ZBUS_LISTENER_DEFINE(lis_dump_##service##_evt, dump_listener_callback_##service##_evt);    \
	ZBUS_CHAN_ADD_OBS(chan_##service##_evt, lis_dump_##service##_evt, 3)

#define NANO_SERVICE_CMD_HANDLER(service, SERVICE)                                                 \
	static int cmd_handler_##service##_cmd(const struct shell *sh, size_t argc, char **argv,   \
					       void *data)                                         \
	{                                                                                          \
		const char *hex_string = argv[1];                                                  \
		uint8_t buffer[128] = {0};                                                         \
		size_t binary_length = hex2bin(hex_string, strlen(hex_string), buffer, 128);       \
		pb_istream_t stream = pb_istream_from_buffer(buffer, binary_length);               \
		struct msg_##service##_cmd cmd = MSG_##SERVICE##_CMD_INIT_DEFAULT;                 \
		bool status = pb_decode(&stream, MSG_##SERVICE##_CMD_FIELDS, &cmd);                \
		if (status) {                                                                      \
			int err = zbus_chan_pub(&chan_##service##_cmd, &cmd, K_MSEC(500));         \
			if (err) {                                                                 \
				shell_error(sh, "!Error: could not publish the encoded data");     \
				return err;                                                        \
			}                                                                          \
		} else {                                                                           \
			shell_error(sh, "!Error: invalid encoded data");                           \
		}                                                                                  \
		return status == true;                                                             \
	}                                                                                          \
	SHELL_CMD_ARG_REGISTER(service##_cmd, NULL, #service " command interface.",                \
			       cmd_handler_##service##_cmd, 2, 0)
```

## src/button_trigger.c
```c
#include <zephyr/kernel.h>
#include <zephyr/device.h>
#include <zephyr/drivers/gpio.h>
#include <zephyr/sys/util.h>
#include <inttypes.h>
#include <zephyr/logging/log.h>
#include <zephyr/zbus/zbus.h>

#include "services/trigger.h"

LOG_MODULE_DECLARE(app, CONFIG_APP_LOG_LEVEL);

/*
 * Get button configuration from the devicetree sw0 alias. This is mandatory.
 */
#define SW0_NODE DT_ALIAS(sw0)
#if !DT_NODE_HAS_STATUS(SW0_NODE, okay)
#error "Unsupported board: sw0 devicetree alias is not defined"
#endif

static const struct gpio_dt_spec button = GPIO_DT_SPEC_GET_OR(SW0_NODE, gpios, {0});
static struct gpio_callback button_cb_data;

void button_pressed(const struct device *dev, struct gpio_callback *cb, uint32_t pins)
{
	LOG_INF("Button pressed at %" PRIu32, k_cycle_get_32());

	zbus_chan_pub(&chan_trigger_evt,
		      MSG_TRIGGER_EVT(.which_trigger_evt = MSG_TRIGGER_EVT_ACTIVATED_TAG),
		      K_NO_WAIT);
}

void button_thread(void)
{
	int err;

	if (!gpio_is_ready_dt(&button)) {
		zbus_chan_pub(&chan_trigger_evt,
			      MSG_TRIGGER_EVT(.which_trigger_evt = MSG_TRIGGER_EVT_FAILED_TAG,
					      .failed = {.error_code = -ENODEV}),
			      K_MSEC(500));

		return;
	}

	err = gpio_pin_configure_dt(&button, GPIO_INPUT);
	if (err != 0) {
		zbus_chan_pub(&chan_trigger_evt,
			      MSG_TRIGGER_EVT(.which_trigger_evt = MSG_TRIGGER_EVT_FAILED_TAG,
					      .failed = {.error_code = err}),
			      K_MSEC(500));

		return;
	}

	err = gpio_pin_interrupt_configure_dt(&button, GPIO_INT_EDGE_TO_ACTIVE);
	if (err != 0) {
		zbus_chan_pub(&chan_trigger_evt,
			      MSG_TRIGGER_EVT(.which_trigger_evt = MSG_TRIGGER_EVT_FAILED_TAG,
					      .failed = {.error_code = err}),
			      K_MSEC(500));

		return;
	}

	gpio_init_callback(&button_cb_data, button_pressed, BIT(button.pin));

	gpio_add_callback(button.port, &button_cb_data);

	LOG_INF("Set up button at %s pin %d", button.port->name, button.pin);

	zbus_chan_pub(&chan_trigger_evt,
		      MSG_TRIGGER_EVT(.which_trigger_evt = MSG_TRIGGER_EVT_READY_TAG), K_MSEC(500));
}

K_THREAD_DEFINE(button_thread_id, 2048, button_thread, NULL, NULL, NULL, 3, 0, 0);
```

## src/led_indicator.c
```c
#include <zephyr/kernel.h>
#include <zephyr/device.h>
#include <zephyr/drivers/gpio.h>
#include <zephyr/sys/util.h>
#include <zephyr/logging/log.h>

#include "ifaces/indicator.h"
#include "ifaces/trigger.h"

LOG_MODULE_DECLARE(app, CONFIG_APP_LOG_LEVEL);

static struct {
	struct gpio_dt_spec led;
	bool is_on;
	int pulse_duration;
} self = {.led = GPIO_DT_SPEC_GET_OR(DT_ALIAS(led0), gpios, {0}),
	  .is_on = false,
	  .pulse_duration = 100};

ZBUS_MSG_SUBSCRIBER_DEFINE(msub_led_indicator);

ZBUS_CHAN_ADD_OBS(chan_trigger_event, msub_led_indicator, 3);
ZBUS_CHAN_ADD_OBS(chan_indicator_command, msub_led_indicator, 3);

static inline void update_led_state(void)
{
	gpio_pin_set_dt(&self.led, self.is_on);
}

static inline void toggle(void)
{
	self.is_on = !self.is_on;
	update_led_state();
}

static inline void pulse(void)
{
	toggle();
	k_msleep(self.pulse_duration);
	toggle();
}

void led_thread(void)
{
	int err;

	if (self.led.port && !gpio_is_ready_dt(&self.led)) {
		zbus_chan_pub(
			&chan_indicator_event,
			MSG_INDICATOR_EVT(.which_indicator_evt = MSG_INDICATOR_EVENT_FAILED_TAG,
					  .failed = {.error_code = -ENODEV}),
			K_MSEC(500));

		return;
	}

	err = gpio_pin_configure_dt(&self.led, GPIO_OUTPUT);
	if (err != 0) {
		zbus_chan_pub(
			&chan_indicator_event,
			MSG_INDICATOR_EVT(.which_indicator_evt = MSG_INDICATOR_EVENT_FAILED_TAG,
					  .failed = {.error_code = err}),
			K_MSEC(500));

		return;
	}

	gpio_pin_set_dt(&self.led, 0);

	LOG_INF("Set up LED at %s pin %d", self.led.port->name, self.led.pin);

	zbus_chan_pub(&chan_indicator_event,
		      MSG_INDICATOR_EVT(.which_indicator_evt = MSG_INDICATOR_EVENT_READY_TAG),
		      K_MSEC(500));

	const struct zbus_channel *chan;

	union {
		struct msg_indicator_command indicator_cmd;
		struct msg_trigger_event trigger_evt;
	} msg;

	zbus_obs_attach_to_thread(&msub_led_indicator);

	while (1) {
		zbus_sub_wait_msg(&msub_led_indicator, &chan, &msg, K_FOREVER);
		if (chan == &chan_trigger_event) {
			switch (msg.trigger_evt.which_trigger_evt) {
			case MSG_TRIGGER_EVENT_ACTIVATED_TAG:
				pulse();
				break;
			default:
				/* Trigger event discarded */
				break;
			}

		} else if (chan == &chan_indicator_command) {
			switch (msg.indicator_cmd.which_indicator_cmd) {
			case MSG_INDICATOR_COMMAND_OFF_TAG:
				self.is_on = false;
				update_led_state();
				break;
			case MSG_INDICATOR_COMMAND_ON_TAG:
				self.is_on = true;
				update_led_state();
				break;
			case MSG_INDICATOR_COMMAND_TOGGLE_TAG:

				toggle();
				break;
			case MSG_INDICATOR_COMMAND_PULSE_TAG:
				pulse();
				break;
			case MSG_INDICATOR_COMMAND_GET_PULSE_CONFIG_TAG: {
				zbus_chan_pub(
					&chan_indicator_response,
					MSG_INDICATOR_RSP(
							.which_indicator_rsp =
								MSG_INDICATOR_RESPONSE_PULSE_CONFIG_TAG,
							.pulse_config =
								{.duration = self.pulse_duration}),
					K_MSEC(250));
				break;
			}
			case MSG_INDICATOR_COMMAND_SET_PULSE_CONFIG_TAG: {
				self.pulse_duration = msg.indicator_cmd.set_pulse_config.duration;
				zbus_chan_pub(
					&chan_indicator_response,
					MSG_INDICATOR_RSP(
							.which_indicator_rsp =
								MSG_INDICATOR_RESPONSE_PULSE_CONFIG_TAG,
							.pulse_config =
								{.duration = self.pulse_duration}),
					K_MSEC(250));
				break;
			}
			default:
				LOG_ERR("Indicator action invalid %d",
					msg.indicator_cmd.which_indicator_cmd);
			}
		}
	}
}

K_THREAD_DEFINE(led_thread_id, 2048, led_thread, NULL, NULL, NULL, 4, 0, 0);
```

## src/timer_trigger.c
```c
#include <zephyr/kernel.h>
#include <zephyr/zbus/zbus.h>

#include "ifaces/trigger.h"

struct msg_timer_trigger_settings {
	int timeout;
};

void timer_trigger_handler(struct k_timer *dummy)
{
	zbus_chan_pub(&chan_trigger_event,
		      MSG_TRIGGER_EVT(.which_trigger_evt = MSG_TRIGGER_EVENT_ACTIVATED_TAG),
		      K_NO_WAIT);
}

K_TIMER_DEFINE(timer_trigger, timer_trigger_handler, NULL);

void timer_trigger_timout_lis_callback(const struct zbus_channel *chan)
{
	const struct msg_timer_trigger_settings *timer_settings = zbus_chan_const_msg(chan);

	k_timer_start(&timer_trigger, K_MSEC(timer_settings->timeout),
		      K_MSEC(timer_settings->timeout));
}

ZBUS_LISTENER_DEFINE(lis_timer_trigger, timer_trigger_timout_lis_callback);

ZBUS_CHAN_DEFINE(chan_timer_trigger_settings, struct msg_timer_trigger_settings, NULL, NULL,
		 ZBUS_OBSERVERS(lis_timer_trigger), ZBUS_MSG_INIT(.timeout = 1000));

int timer_trigger_init(void)
{
	timer_trigger_timout_lis_callback(&chan_timer_trigger_settings);

	zbus_chan_pub(&chan_trigger_event,
		      MSG_TRIGGER_EVT(.which_trigger_evt = MSG_TRIGGER_EVENT_READY_TAG), K_NO_WAIT);

	return 0;
}
SYS_INIT(timer_trigger_init, APPLICATION, 99);

#if defined(CONFIG_SHELL)
#include <stdlib.h>
#include <zephyr/shell/shell.h>

#define ZBUS_CHAN_LOCK(_chan, _timeout, _err)                                                      \
	for (int i = 0, e = zbus_chan_claim(_chan, _timeout); e == 0 && i == 0;                    \
	     zbus_chan_finish(_chan), *(_err) = e, ++i)

static int trigger_timeout_get_cmd_handler(const struct shell *sh, size_t argc, char **argv,
					   void *data)
{
	int err;
	struct msg_timer_trigger_settings timer_settings;

	err = zbus_chan_read(&chan_timer_trigger_settings, &timer_settings, K_MSEC(500));
	if (err) {
		shell_error(sh, "Could not retrieve the trigger timeout");

		return err;
	}

	shell_print(sh, "Timer trigger timeout: %d", timer_settings.timeout);

	return 0;
}

static int trigger_timeout_set_cmd_handler(const struct shell *sh, size_t argc, char **argv,
					   void *data)
{
	int err;

	ZBUS_CHAN_LOCK(&chan_timer_trigger_settings, K_MSEC(250), &err)
	{
		struct msg_timer_trigger_settings *timer_settings =
			zbus_chan_msg(&chan_timer_trigger_settings);

		timer_settings->timeout = atoi(argv[1]);
	}

	if (err) {
		shell_error(sh, "Could not set the timeout value");

		return err;
	} else {
		zbus_chan_notify(&chan_timer_trigger_settings, K_MSEC(250));
	}

	return 0;
}

SHELL_STATIC_SUBCMD_SET_CREATE(sub_trigger_timeout,
			       SHELL_CMD(get_timeout, NULL, "Get trigger timeout.",
					 trigger_timeout_get_cmd_handler),
			       SHELL_CMD_ARG(set_timeout, NULL, "Set trigger timeout",
					     trigger_timeout_set_cmd_handler, 2, 0),
			       SHELL_SUBCMD_SET_END);

SHELL_CMD_REGISTER(trigger_timer, &sub_trigger_timeout, "Trigger timer settings", NULL);
#endif /* CONFIG_SHELL */
```
