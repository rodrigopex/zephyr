## CMakeLists.txt
```
# SPDX-License-Identifier: Apache-2.0
cmake_minimum_required(VERSION 3.20.0)

find_package(Zephyr REQUIRED HINTS $ENV{ZEPHYR_BASE})
project(zbus_tutorial)

FILE(GLOB app_sources src/*.c)
target_sources(app PRIVATE ${app_sources})
target_include_directories(app PRIVATE include)
```

## prj.conf
```kconfig
CONFIG_ASSERT=y
CONFIG_LOG=y
CONFIG_ZBUS=y
CONFIG_ZBUS_LOG_LEVEL_INF=y
CONFIG_ZBUS_CHANNEL_NAME=y
CONFIG_ZBUS_OBSERVER_NAME=y
CONFIG_ZBUS_MSG_SUBSCRIBER=y
CONFIG_ZBUS_CHANNEL_NAME=y
CONFIG_HEAP_MEM_POOL_SIZE=2048
CONFIG_TEST_RANDOM_GENERATOR=y
CONFIG_TIMER_RANDOM_GENERATOR=y
```

## src/main.c
```c
/*
 * Copyright (c) 2023 Rodrigo Peixoto <rodrigopex@gmail.com>
 * SPDX-License-Identifier: Apache-2.0
 */
#include "app_info.h"

#include <zephyr/kernel.h>
#include <zephyr/logging/log.h>
#include <zephyr/init.h>
#include <zephyr/zbus/zbus.h>
LOG_MODULE_DECLARE(zbus, CONFIG_ZBUS_LOG_LEVEL);

ZBUS_CHAN_DECLARE(chan_app_info, chan_sensor_out__data, chan_sensor_in__fetch,
		  chan_lora_in__payload, chan_lora_out__transmission_done);

struct k_work start_trigger_work;

void execute_start_trigger(struct k_work *work)
{
	zbus_chan_notify(&chan_sensor_in__fetch, K_MSEC(250));
}

void trigger_timer_handler(struct k_timer *dummy)
{
	k_work_submit(&start_trigger_work);
}

K_TIMER_DEFINE(trigger_timer, trigger_timer_handler, NULL);

int main(void)
{
	/* Pretend to fetch some data from external source to describe hardware and the samples
	 * timeout */
	//...
	zbus_chan_claim(&chan_app_info, K_FOREVER);

	struct app_info_msg *app_info = (struct app_info_msg *)zbus_chan_msg(&chan_app_info);

	app_info->hardware_version.major = 'P';

	strncpy(app_info->hardware_version.minor, "07X", 4);

	app_info->sample_timeout = 3000;

	bool *locked = zbus_chan_user_data(&chan_app_info);
	*locked = true;

	zbus_chan_finish(&chan_app_info);

	/* Is using app_info safe?!?! */
	LOG_INF("%s (serial number:%s)", app_info->model, app_info->serial_number);

	LOG_INF(" - Firmware v%u.%u.%u", app_info->firmware_version.major,
		app_info->firmware_version.minor, app_info->firmware_version.patch);

	LOG_INF(" - Hardware %c%s", app_info->hardware_version.major,
		app_info->hardware_version.minor);

	/* while (1) { */
	/* 	zbus_chan_notify(&start_trigger_chan, K_FOREVER); */
	/**/
	/* 	k_msleep(2000); */
	/* } */

	k_work_init(&start_trigger_work, execute_start_trigger);

	k_timer_start(&trigger_timer, K_MSEC(app_info->sample_timeout),
		      K_MSEC(app_info->sample_timeout));

	LOG_WRN("app_info pub (err == -ENOMSG) -> %d",
		zbus_chan_pub(&chan_app_info, app_info, K_FOREVER) == -ENOMSG);

	return 0;
}
```

## include/messages.h
```c
/*
 * Copyright (c) 2023 Rodrigo Peixoto <rodrigopex@gmail.com>
 * SPDX-License-Identifier: Apache-2.0
 */
#ifndef _MESSAGES_H_
#define _MESSAGES_H_

#include <stdint.h>

struct sensor_data_msg {
	int x;
	int y;
	int z;
};

struct payload_msg {
	uint64_t sum;
};

#endif // _MESSAGES_H_
```

## src/app_info.c
```c
/*
 * Copyright (c) 2023 Rodrigo Peixoto <rodrigopex@gmail.com>
 * SPDX-License-Identifier: Apache-2.0
 */
#include "app_info.h"

#include <zephyr/kernel.h>
#include <zephyr/zbus/zbus.h>

static bool locked = false;

static bool validator(const void *msg, size_t msg_size);

ZBUS_CHAN_DEFINE(chan_app_info,       /* Channel name */
		 struct app_info_msg, /* Message type */

		 validator,            /* Validator */
		 &locked,              /* User data */
		 ZBUS_OBSERVERS_EMPTY, /* Observers */
		 ZBUS_MSG_INIT(.firmware_version = {0, 1, 2}, .hardware_version = {'V', "01A"},
			       .serial_number = "bNojO6UjtM0gIflI9HcAVPDqF7vX1aH7",
			       .model = "ZBusIoT1"));

static bool validator(const void *msg, size_t msg_size)
{
	bool *locked = zbus_chan_user_data(&chan_app_info);
	return (*locked == false);
}
```

## src/core_thread.c
```c
/*
 * Copyright (c) 2023 Rodrigo Peixoto <rodrigopex@gmail.com>
 * SPDX-License-Identifier: Apache-2.0
 */
#include "messages.h"
#include <stdint.h>

#include <zephyr/logging/log.h>
#include <zephyr/kernel.h>
#include <zephyr/zbus/zbus.h>
#include <zephyr/init.h>
LOG_MODULE_DECLARE(zbus, CONFIG_ZBUS_LOG_LEVEL);

ZBUS_CHAN_DECLARE(chan_sensor_out__data, chan_lora_in__payload, chan_lora_out__transmission_done);

ZBUS_MSG_SUBSCRIBER_DEFINE(msub_core);

ZBUS_CHAN_ADD_OBS(chan_sensor_out__data, msub_core, 3);
ZBUS_CHAN_ADD_OBS(chan_lora_out__transmission_done, msub_core, 3);

void core_thread()
{
	LOG_INF("Core thread started!");

	const struct zbus_channel *chan;

	union {
		struct sensor_data_msg sensor_data;
		bool transmission_done;
	} core_msg = {0};

	uint64_t payload = 0;
	bool retry = true;

	while (!zbus_sub_wait_msg(&msub_core, &chan, &core_msg, K_FOREVER)) {
		if (chan == &chan_sensor_out__data) {
			payload = core_msg.sensor_data.x + core_msg.sensor_data.y +
				  core_msg.sensor_data.y;

			retry = 1;
			zbus_chan_pub(&chan_lora_in__payload, &payload, K_MSEC(500));
		} else {
			if (core_msg.transmission_done) {
				/* Do nothing! */
			} else if ((core_msg.transmission_done == false) && retry) {
				LOG_WRN("Retrying to send the payload");
				retry = false;
				zbus_chan_notify(&chan_lora_in__payload, K_MSEC(500));
			} else {
				LOG_ERR("Could not send the payload");
			}
		}
	}
}

K_THREAD_DEFINE(core_thread_id, 1024, core_thread, NULL, NULL, NULL, 3, 0, 0);
```

## src/lora_thread.c
```c
/*
 * Copyright (c) 2023 Rodrigo Peixoto <rodrigopex@gmail.com>
 * SPDX-License-Identifier: Apache-2.0
 */
#include "messages.h"

#include <zephyr/logging/log.h>
#include <zephyr/kernel.h>
#include <zephyr/zbus/zbus.h>
#include <zephyr/random/random.h>
LOG_MODULE_DECLARE(zbus, CONFIG_ZBUS_LOG_LEVEL);

ZBUS_CHAN_DEFINE(chan_lora_in__payload,     /* Channel name */
		 uint64_t,                  /* Message type */
		 NULL,                      /* User data */
		 NULL,                      /* Validator */
		 ZBUS_OBSERVERS(msub_lora), /* Observers */
		 0);

ZBUS_CHAN_DEFINE(chan_lora_out__transmission_done, /* Channel name */
		 bool,                             /* Message type */
		 NULL,                             /* User data */
		 NULL,                             /* Validator */
		 ZBUS_OBSERVERS_EMPTY,             /* Observers */
		 false);

ZBUS_MSG_SUBSCRIBER_DEFINE(msub_lora);

void lora_thread()
{
	LOG_INF("Lora thread started!");

	const struct zbus_channel *chan;

	bool transmission_done;

	uint64_t payload;

	while (!zbus_sub_wait_msg(&msub_lora, &chan, &payload, K_FOREVER)) {

		/* To simulate the transmission delay. In a imaginary scenario, if the transmission
		 * takes more than 500 ms, it will fail.*/
		int32_t rand_delay = sys_rand32_get() % 1000;

		LOG_INF(" ---> Sending packet to the network server...(%d ms)", rand_delay);
		k_msleep(rand_delay);

		transmission_done = (rand_delay % 2) == 0;

		zbus_chan_pub(&chan_lora_out__transmission_done, &transmission_done, K_MSEC(500));
	}
}

K_THREAD_DEFINE(lora_thread_id, 1024, lora_thread, NULL, NULL, NULL, 4, 0, 0);
```

## src/mock.c
```c
/*
 * Copyright (c) 2023 Rodrigo Peixoto <rodrigopex@gmail.com>
 * SPDX-License-Identifier: Apache-2.0
 */
#include <zephyr/kernel.h>
#include <zephyr/logging/log.h>
#include <zephyr/zbus/zbus.h>
LOG_MODULE_DECLARE(zbus, CONFIG_ZBUS_LOG_LEVEL);

ZBUS_CHAN_DECLARE(chan_sensor_out__data, chan_lora_in__payload, chan_lora_out__transmission_done);

void mock(const struct zbus_channel *chan)
{
	LOG_INF("Data received on channel %s", zbus_chan_name(chan));
	LOG_HEXDUMP_INF(zbus_chan_const_msg(chan), zbus_chan_msg_size(chan), "Msg content:");
}

ZBUS_LISTENER_DEFINE(lis_mock, mock);

ZBUS_CHAN_ADD_OBS(chan_sensor_out__data, lis_mock, 3);
ZBUS_CHAN_ADD_OBS(chan_lora_in__payload, lis_mock, 3);
ZBUS_CHAN_ADD_OBS(chan_lora_out__transmission_done, lis_mock, 3);
```

## src/sensor_thread.c
```c
/*
 * Copyright (c) 2023 Rodrigo Peixoto <rodrigopex@gmail.com>
 * SPDX-License-Identifier: Apache-2.0
 */
#include "messages.h"
#include <native_rtc.h>

#include <zephyr/kernel.h>
#include <zephyr/zbus/zbus.h>

#define GET_TIME_IN_NS() (native_rtc_gettime_us(RTC_CLOCK_PSEUDOHOSTREALTIME) * NSEC_PER_USEC)

ZBUS_CHAN_DEFINE(chan_sensor_in__fetch,      /* Channel name */
		 bool,                       /* Message type */
		 NULL,                       /* User data */
		 NULL,                       /* Validator */
		 ZBUS_OBSERVERS(sub_sensor), /* Observers */
		 false);

ZBUS_CHAN_DEFINE(chan_sensor_out__data,  /* Channel name */
		 struct sensor_data_msg, /* Message type */
		 NULL,                   /* User data */
		 NULL,                   /* Validator */
		 ZBUS_OBSERVERS_EMPTY,   /* Observers */
		 ZBUS_MSG_INIT(0));

ZBUS_SUBSCRIBER_DEFINE(sub_sensor, 4);

void sensor_thread()
{
	const struct zbus_channel *chan;

	struct sensor_data_msg sdata = {.x = 0, .y = 0, .z = 0};

	while (1) {
		zbus_sub_wait(&sub_sensor, &chan, K_FOREVER);

		sdata.x += 1;
		sdata.y += 10;
		sdata.z += 100;

		uint64_t start = GET_TIME_IN_NS();
		zbus_chan_pub(&chan_sensor_out__data, &sdata, K_MSEC(500));
		uint64_t delta = GET_TIME_IN_NS() - start;

		printk(" *** Publishing duration: %lluus\n", delta / 1000);
	}
}

K_THREAD_DEFINE(sensor_thread_id, 1024, sensor_thread, NULL, NULL, NULL, 3, 0, 0);
```
