## CMakeLists.txt
```
# SPDX-License-Identifier: Apache-2.0
cmake_minimum_required(VERSION 3.20.0)

find_package(Zephyr REQUIRED HINTS $ENV{ZEPHYR_BASE})
project(zbus_tutorial)

FILE(GLOB app_sources src/*.c)
target_sources(app PRIVATE ${app_sources})
```

## Kconfig
```
# Copyright (c) 2023 Rodrigo Peixoto <rodrigopex@gmail.com>
# SPDX-License-Identifier: Apache-2.0

config CORE_AS_LISTENER
	bool "The core logic executes inside a listener"
	default y

source "Kconfig.zephyr"
```

## prj.conf
```kconfig
CONFIG_ASSERT=y
CONFIG_LOG=y
CONFIG_ZBUS=y
CONFIG_ZBUS_LOG_LEVEL_DBG=y
CONFIG_ZBUS_RUNTIME_OBSERVERS=y
CONFIG_HEAP_MEM_POOL_SIZE=2048
CONFIG_ZBUS_CHANNEL_NAME=y
CONFIG_CORE_AS_LISTENER=y
```

## src/main.c
```c
/*
 * Copyright (c) 2023 Rodrigo Peixoto <rodrigopex@gmail.com>
 * SPDX-License-Identifier: Apache-2.0
 */
#include "app_info.h"

#include <zephyr/kernel.h>
#include <zephyr/logging/log.h>
#include <zephyr/init.h>
#include <zephyr/zbus/zbus.h>
LOG_MODULE_DECLARE(zbus, CONFIG_ZBUS_LOG_LEVEL);

ZBUS_CHAN_DECLARE(app_info_chan, sensor_data_chan);

ZBUS_OBS_DECLARE(sensor_thread_sub, core_lis, core_thread_sub, lora_thread_sub, mock_lis);

ZBUS_CHAN_DEFINE(start_trigger_chan,                /* Channel name */
		 bool,                              /* Message type */
		 NULL,                              /* User data */
		 NULL,                              /* Validator */
		 ZBUS_OBSERVERS(sensor_thread_sub), /* Observers */
		 false);

ZBUS_CHAN_DEFINE(payload_chan,                    /* Channel name */
		 uint64_t,                        /* Message type */
		 NULL,                            /* User data */
		 NULL,                            /* Validator */
		 ZBUS_OBSERVERS(lora_thread_sub), /* Observers */
		 0);

ZBUS_CHAN_DEFINE(transmission_done_chan, /* Channel name */
		 bool,                   /* Message type */
		 NULL,                   /* User data */
		 NULL,                   /* Validator */
		 ZBUS_OBSERVERS_EMPTY,   /* Observers */
		 false);

struct k_work start_trigger_work;

void execute_start_trigger(struct k_work *work)
{
	zbus_chan_notify(&start_trigger_chan, K_MSEC(250));
}

void trigger_timer_handler(struct k_timer *dummy)
{
	k_work_submit(&start_trigger_work);
}

K_TIMER_DEFINE(trigger_timer, trigger_timer_handler, NULL);

ZBUS_CHAN_ADD_OBS(sensor_data_chan, mock_lis, 3);
ZBUS_CHAN_ADD_OBS(payload_chan, mock_lis, 3);
ZBUS_CHAN_ADD_OBS(transmission_done_chan, mock_lis, 3);

int main(void)
{
	/* Pretend to fetch some data from external source to describe hardware and the samples
	 * timeout */
	//...
	zbus_chan_claim(&app_info_chan, K_FOREVER);

	struct app_info_msg *app_info = (struct app_info_msg *)zbus_chan_msg(&app_info_chan);

	app_info->hardware_version.major = 'P';

	strncpy(app_info->hardware_version.minor, "07X", 4);

	app_info->sample_timeout = 3000;

	bool *locked = zbus_chan_user_data(&app_info_chan);
	*locked = true;

	zbus_chan_finish(&app_info_chan);

	/* Is using app_info safe?!?! */
	LOG_INF("%s (serial number:%s)", app_info->model, app_info->serial_number);

	LOG_INF(" - Firmware v%u.%u.%u", app_info->firmware_version.major,
		app_info->firmware_version.minor, app_info->firmware_version.patch);

	LOG_INF(" - Hardware %c%s", app_info->hardware_version.major,
		app_info->hardware_version.minor);

	/* while (1) { */
	/* 	zbus_chan_notify(&start_trigger_chan, K_FOREVER); */
	/**/
	/* 	k_msleep(2000); */
	/* } */

	k_work_init(&start_trigger_work, execute_start_trigger);

	k_timer_start(&trigger_timer, K_MSEC(app_info->sample_timeout),
		      K_MSEC(app_info->sample_timeout));

	LOG_WRN("app_info pub (err == -ENOMSG) -> %d",
		zbus_chan_pub(&app_info_chan, app_info, K_FOREVER) == -ENOMSG);

	return 0;
}
```

## include/app_info.h
```c
/*
 * Copyright (c) 2023 Rodrigo Peixoto <rodrigopex@gmail.com>
 * SPDX-License-Identifier: Apache-2.0
 */
#ifndef _PROJECT_INFO_H_
#define _PROJECT_INFO_H_

#include <stdint.h>

struct app_info_msg {
	const struct {
		uint8_t major;
		uint8_t minor;
		uint8_t patch;
	} firmware_version;
	struct {
		char major;
		char minor[4];
	} hardware_version;
	const char serial_number[32];
	const char model[16];
	uint32_t sample_timeout;
};

#endif // _PROJECT_INFO_H_
```

## include/messages.h
```c
/*
 * Copyright (c) 2023 Rodrigo Peixoto <rodrigopex@gmail.com>
 * SPDX-License-Identifier: Apache-2.0
 */
#ifndef _MESSAGES_H_
#define _MESSAGES_H_

#include <stdint.h>

struct sensor_data_msg {
	int x;
	int y;
	int z;
};

#endif // _MESSAGES_H_
```

## include/project_info.h
```c
/*
 * Copyright (c) 2023 Rodrigo Peixoto <rodrigopex@gmail.com>
 * SPDX-License-Identifier: Apache-2.0
 */
#ifndef _PROJECT_INFO_H_
#define _PROJECT_INFO_H_

#include <stdint.h>

struct project_info_msg {
	const struct {
		uint8_t major;
		uint8_t minor;
		uint8_t patch;
	} firmware_version;
	const struct {
		char major;
		char minor[4];
	} hardware_version;
	const char serial_number[32];
	const char model[16];
};

#endif // _PROJECT_INFO_H_
```

## src/app_info.c
```c
/*
 * Copyright (c) 2023 Rodrigo Peixoto <rodrigopex@gmail.com>
 * SPDX-License-Identifier: Apache-2.0
 */
#include "app_info.h"

#include <zephyr/kernel.h>
#include <zephyr/zbus/zbus.h>

static bool locked = false;

static bool validator(const void *msg, size_t msg_size);

ZBUS_CHAN_DEFINE(app_info_chan,       /* Channel name */
		 struct app_info_msg, /* Message type */

		 validator,            /* Validator */
		 &locked,              /* User data */
		 ZBUS_OBSERVERS_EMPTY, /* Observers */
		 ZBUS_MSG_INIT(.firmware_version = {0, 1, 2}, .hardware_version = {'V', "01A"},
			       .serial_number = "bNojO6UjtM0gIflI9HcAVPDqF7vX1aH7",
			       .model = "ZBusIoT1"));

static bool validator(const void *msg, size_t msg_size)
{
	bool *locked = zbus_chan_user_data(&app_info_chan);
	return (*locked == false);
}
```

## src/core_thread.c
```c
/*
 * Copyright (c) 2023 Rodrigo Peixoto <rodrigopex@gmail.com>
 * SPDX-License-Identifier: Apache-2.0
 */
#include "messages.h"
#include <stdint.h>

#include <zephyr/logging/log.h>
#include <zephyr/kernel.h>
#include <zephyr/zbus/zbus.h>
#include <zephyr/init.h>
LOG_MODULE_DECLARE(zbus, CONFIG_ZBUS_LOG_LEVEL);

ZBUS_CHAN_DECLARE(sensor_data_chan, payload_chan, transmission_done_chan);

#if defined(CONFIG_CORE_AS_LISTENER)

void core_listener_callback(const struct zbus_channel *chan)
{
	struct sensor_data_msg *sdata = (struct sensor_data_msg *)zbus_chan_const_msg(chan);

	uint64_t payload = sdata->x + sdata->y + sdata->z;

	zbus_chan_pub(&payload_chan, &payload, K_NO_WAIT);
}

ZBUS_LISTENER_DEFINE(core_lis, core_listener_callback);

ZBUS_CHAN_ADD_OBS(sensor_data_chan, core_lis, 3);

#else

ZBUS_SUBSCRIBER_DEFINE(core_thread_sub, 4);

ZBUS_CHAN_ADD_OBS(sensor_data_chan, core_thread_sub, 3);
ZBUS_CHAN_ADD_OBS(transmission_done_chan, core_thread_sub, 3);

void core_thread()
{
	LOG_INF("Core thread started!");

	const struct zbus_channel *chan;

	struct sensor_data_msg sdata = {.x = 0, .y = 0, .z = 0};

	uint64_t payload = 0;
	bool retry = true;

	while (!zbus_sub_wait(&core_thread_sub, &chan, K_FOREVER)) {
		if (chan == &sensor_data_chan) {
			int err = zbus_chan_read(&sensor_data_chan, &sdata, K_MSEC(500));
			if (err) {
				LOG_WRN("Could not read the channel. Error code: %d", err);
			} else {
				payload = sdata.x + sdata.y + sdata.z;

				retry = 1;
				zbus_chan_pub(&payload_chan, &payload, K_MSEC(500));
			}
		} else {
			bool *transmission_done =
				(bool *)zbus_chan_const_msg(&transmission_done_chan);

			if (*transmission_done) {
				/* Do nothing! */
			} else if ((*transmission_done == false) && retry) {
				LOG_WRN("Retrying to send the payload");
				retry = false;
				zbus_chan_notify(&payload_chan, K_MSEC(500));
			} else {
				LOG_ERR("Could not send the payload");
			}
		}
	}
}

K_THREAD_DEFINE(core_thread_id, 1024, core_thread, NULL, NULL, NULL, 3, 0, 0);

#endif
```

## src/lora_thread.c
```c
/*
 * Copyright (c) 2023 Rodrigo Peixoto <rodrigopex@gmail.com>
 * SPDX-License-Identifier: Apache-2.0
 */
#include "messages.h"

#include <zephyr/logging/log.h>
#include <zephyr/kernel.h>
#include <zephyr/zbus/zbus.h>
LOG_MODULE_DECLARE(zbus, CONFIG_ZBUS_LOG_LEVEL);

ZBUS_CHAN_DECLARE(payload_chan, transmission_done_chan);

ZBUS_SUBSCRIBER_DEFINE(lora_thread_sub, 4);

void lora_thread()
{
	LOG_INF("Lora thread started!");

	const struct zbus_channel *chan;

	uint64_t payload = 0;

	bool transmission_done = false;

	while (!zbus_sub_wait(&lora_thread_sub, &chan, K_FOREVER)) {

		int err = zbus_chan_read(&payload_chan, &payload, K_MSEC(500));
		if (err) {
			LOG_WRN("Could not read the channel. Error code: %d", err);
		} else {
			/* To simulate the transmission delay */
			k_msleep(1000);

			zbus_chan_pub(&transmission_done_chan, &transmission_done, K_MSEC(500));
		}
	}
}

K_THREAD_DEFINE(lora_thread_id, 1024, lora_thread, NULL, NULL, NULL, 4, 0, 0);
```

## src/mock.c
```c
/*
 * Copyright (c) 2023 Rodrigo Peixoto <rodrigopex@gmail.com>
 * SPDX-License-Identifier: Apache-2.0
 */
#include <zephyr/kernel.h>
#include <zephyr/logging/log.h>
#include <zephyr/zbus/zbus.h>
LOG_MODULE_DECLARE(zbus, CONFIG_ZBUS_LOG_LEVEL);

void mock(const struct zbus_channel *chan)
{
	LOG_INF("Data received on channel %s", zbus_chan_name(chan));
	LOG_HEXDUMP_INF(zbus_chan_const_msg(chan), zbus_chan_msg_size(chan), "Msg content:");
}

ZBUS_LISTENER_DEFINE(mock_lis, mock);
```

## src/project_info.c
```c
/*
 * Copyright (c) 2023 Rodrigo Peixoto <rodrigopex@gmail.com>
 * SPDX-License-Identifier: Apache-2.0
 */
#include "project_info.h"

#include <zephyr/kernel.h>
#include <zephyr/zbus/zbus.h>

ZBUS_CHAN_DEFINE(project_info_chan,       /* Channel name */
		 struct project_info_msg, /* Message type */
		 NULL,                    /* User data */
		 NULL,                    /* Validator */
		 ZBUS_OBSERVERS_EMPTY,    /* Observers */
		 ZBUS_MSG_INIT(.firmware_version = {0, 1, 2}, .hardware_version = {'V', "01A"},
			       .serial_number = "bNojO6UjtM0gIflI9HcAVPDqF7vX1aH7",
			       .model = "ZBusIoT1"));
```

## src/sensor_thread.c
```c
/*
 * Copyright (c) 2023 Rodrigo Peixoto <rodrigopex@gmail.com>
 * SPDX-License-Identifier: Apache-2.0
 */
#include "messages.h"

#include <zephyr/kernel.h>
#include <zephyr/zbus/zbus.h>

ZBUS_SUBSCRIBER_DEFINE(sensor_thread_sub, 4);

ZBUS_CHAN_DEFINE(sensor_data_chan,       /* Channel name */
		 struct sensor_data_msg, /* Message type */
		 NULL,                   /* User data */
		 NULL,                   /* Validator */
		 ZBUS_OBSERVERS_EMPTY,   /* Observers */
		 ZBUS_MSG_INIT(0));

void sensor_thread()
{
	const struct zbus_channel *chan;

	struct sensor_data_msg sdata = {.x = 0, .y = 0, .z = 0};

	while (1) {
		zbus_sub_wait(&sensor_thread_sub, &chan, K_FOREVER);

		sdata.x += 1;
		sdata.y += 10;
		sdata.z += 100;

		zbus_chan_pub(&sensor_data_chan, &sdata, K_MSEC(500));
	}
}

K_THREAD_DEFINE(sensor_thread_id, 1024, sensor_thread, NULL, NULL, NULL, 3, 0, 0);
```
