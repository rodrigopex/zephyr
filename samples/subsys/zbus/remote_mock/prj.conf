## prj.conf
```kconfig
CONFIG_LOG=y
CONFIG_LOG_MODE_MINIMAL=n
CONFIG_THREAD_NAME=y
CONFIG_ASSERT=y

CONFIG_SERIAL=y
CONFIG_UART_LINE_CTRL=n

CONFIG_NET_BUF=y
CONFIG_NET_BUF_LOG=y
CONFIG_NET_BUF_SIMPLE_LOG=y

CONFIG_ZBUS=y
CONFIG_ZBUS_LOG_LEVEL_DBG=y
CONFIG_ZBUS_CHANNEL_NAME=y
CONFIG_ZBUS_CHANNEL_USER_DATA_SIZE=1
```

## prj_hifive1_revb.conf
```kconfig
CONFIG_LOG=y
CONFIG_LOG_MODE_MINIMAL=y
CONFIG_THREAD_NAME=y
CONFIG_ASSERT=y

CONFIG_SERIAL=y
CONFIG_UART_LINE_CTRL=n
CONFIG_UART_SIFIVE_PORT_1=y
CONFIG_UART_SIFIVE_PORT_1_TXCNT_IRQ=1
CONFIG_UART_SIFIVE_PORT_1_RXCNT_IRQ=1

CONFIG_NET_BUF=y
CONFIG_NET_BUF_LOG=y
CONFIG_NET_BUF_SIMPLE_LOG=y

CONFIG_ZBUS=y
CONFIG_ZBUS_LOG_LEVEL_DBG=y
CONFIG_ZBUS_CHANNEL_NAME=y
CONFIG_ZBUS_CHANNEL_USER_DATA_SIZE=1
```

## prj_native_posix.conf
```kconfig
CONFIG_LOG=y
CONFIG_LOG_MODE_MINIMAL=y
CONFIG_THREAD_NAME=y
CONFIG_ASSERT=y

CONFIG_SERIAL=y
CONFIG_UART_LINE_CTRL=n
CONFIG_UART_NATIVE_POSIX_PORT_1_ENABLE=y
CONFIG_NATIVE_POSIX_SLOWDOWN_TO_REAL_TIME=y

CONFIG_NET_BUF=y
CONFIG_NET_BUF_LOG=y
CONFIG_NET_BUF_SIMPLE_LOG=y

CONFIG_ZBUS=y
CONFIG_ZBUS_LOG_LEVEL_DBG=y
CONFIG_ZBUS_CHANNEL_NAME=y
CONFIG_ZBUS_CHANNEL_USER_DATA_SIZE=1
```

## src/mock_proxy.c
```c
/*
 * Copyright (c) 2022 Rodrigo Peixoto <rodrigopex@gmail.com>
 * SPDX-License-Identifier: Apache-2.0
 */
#include "messages.h"

#include <stdint.h>
#include <string.h>

#include <zephyr/drivers/uart.h>
#include <zephyr/kernel.h>
#include <zephyr/logging/log.h>
#include <zephyr/net/buf.h>
#include <zephyr/zbus/zbus.h>
LOG_MODULE_DECLARE(zbus, CONFIG_ZBUS_LOG_LEVEL);

const static struct device *uart_dev = DEVICE_DT_GET(DT_NODELABEL(uart1));

ZBUS_CHAN_DECLARE(sensor_data_chan);

ZBUS_CHAN_DEFINE(version_chan,	     /* Name */
		 true,		     /* Read only */
		 struct version_msg, /* Message type */

		 NULL,		       /* Validator */
		 ZBUS_OBSERVERS_EMPTY, /* observers */
		 ZBUS_MSG_INIT(.major = 0, .minor = 1,
			       .build = 1023) /* Initial value major 0, minor 1, build 1023 */
);

ZBUS_CHAN_DEFINE(start_measurement_chan, /* Name */
		 false,			 /* Read only */
		 struct action_msg,	 /* Message type */

		 NULL,					    /* Validator */
		 ZBUS_OBSERVERS(proxy_lis, peripheral_sub), /* observers */
		 ZBUS_MSG_INIT(false)			    /* Initial value */
);

static uint8_t encoder(const struct zbus_channel *chan)
{
	if (chan == &sensor_data_chan) {
		return 1;
	} else if (chan == &start_measurement_chan) {
		return 2;
	}
	return 0;
}

static struct zbus_channel *decoder(uint8_t chan_idx)
{
	if (chan_idx == 1) {
		return &sensor_data_chan;
	} else if (chan_idx == 2) {
		return &start_measurement_chan;
	}
	return NULL;
}

static void proxy_callback(const struct zbus_channel *chan)
{
	bool *generated_by_the_bridge = zbus_chan_user_data(chan);

	if (*generated_by_the_bridge) {
		LOG_DBG("discard loopback event (channel %s)", zbus_chan_name(chan));

		*generated_by_the_bridge = false;
	} else {
		uart_poll_out(uart_dev, '$');

		uart_poll_out(uart_dev, encoder(chan));

		for (int i = 0; i < zbus_chan_msg_size(chan); ++i) {
			uart_poll_out(uart_dev, ((unsigned char *)zbus_chan_const_msg(chan))[i]);
		}

		uart_poll_out(uart_dev, '*');

		LOG_DBG("sending message to host (channel %s)", zbus_chan_name(chan));
	}
}

ZBUS_LISTENER_DEFINE(proxy_lis, proxy_callback);

void main(void)
{
	LOG_DBG("[Mock Proxy] Started.");
}

static void decode_sentence(struct net_buf_simple *rx_buf)
{
	if (rx_buf->len <= 1) {
		LOG_DBG("[Mock Proxy RX] Discard invalid sequence");
		/* '*' indicates the end of a sentence. Sometimes it is
		 * necessary to flush more than on ensure sending it from
		 * the python script. The code must discard when there is no
		 * other data at the buffer.
		 */
	} else {
		if ('$' == net_buf_simple_pull_u8(rx_buf)) {
			LOG_DBG("[Mock Proxy RX] Found sentence");

			struct zbus_channel *chan = decoder(net_buf_simple_pull_u8(rx_buf));

			__ASSERT_NO_MSG(chan != NULL);

			if (!zbus_chan_claim(chan, K_MSEC(250))) {
				memcpy(zbus_chan_msg(chan),
				       net_buf_simple_pull_mem(rx_buf, zbus_chan_msg_size(chan)),
				       zbus_chan_msg_size(chan));

				bool *generated_by_the_bridge = zbus_chan_user_data(chan);
				*generated_by_the_bridge = true;

				zbus_chan_finish(chan);

				LOG_DBG("Publishing channel %s", zbus_chan_name(chan));

				zbus_chan_notify(chan, K_MSEC(500));
			}
		}
		net_buf_simple_init(rx_buf, 0);
	}
}

static void mock_proxy_rx_thread(void)
{
	LOG_DBG("[Mock Proxy RX] Started.");

	uint8_t byte;
	struct net_buf_simple *rx_buf = NET_BUF_SIMPLE(64);

	net_buf_simple_init(rx_buf, 0);

	while (1) {
		while (uart_poll_in(uart_dev, &byte) < 0) {
			/* Allow other thread/workqueue to work. */
			k_msleep(50);
		}
		if (byte == '*') {
			decode_sentence(rx_buf);
		} else {
			net_buf_simple_add_u8(rx_buf, byte);
		}
	}
}

K_THREAD_DEFINE(mock_proxy_rx_thread_tid, 2048, mock_proxy_rx_thread, NULL, NULL, NULL, 5, 0, 1500);
```

## src/peripheral.c
```c
/*
 * Copyright (c) 2022 Rodrigo Peixoto <rodrigopex@gmail.com>
 * SPDX-License-Identifier: Apache-2.0
 */
#include "messages.h"

#include <zephyr/logging/log.h>
#include <zephyr/zbus/zbus.h>
LOG_MODULE_DECLARE(zbus, CONFIG_ZBUS_LOG_LEVEL);

ZBUS_CHAN_DEFINE(sensor_data_chan,	 /* Name */
		 false,			 /* Read only */
		 struct sensor_data_msg, /* Message type */

		 NULL,			    /* Validator */
		 ZBUS_OBSERVERS(proxy_lis), /* observers */
		 ZBUS_MSG_INIT(0)	    /* Initial value {0} */
);

ZBUS_SUBSCRIBER_DEFINE(peripheral_sub, 8);

static void peripheral_thread(void)
{
	struct zbus_channel *chan;
	struct sensor_data_msg sd = {0};

	while (!zbus_sub_wait(&peripheral_sub, &chan, K_FOREVER)) {
		sd.value += 1;

		LOG_DBG("sending sensor data err = %d",
			zbus_chan_pub(&sensor_data_chan, &sd, K_MSEC(250)));
	}
}

K_THREAD_DEFINE(peripheral_thread_id, 1024, peripheral_thread, NULL, NULL, NULL, 5, 0, 0);
```
