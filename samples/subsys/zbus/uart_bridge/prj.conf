## prj.conf
```kconfig
CONFIG_LOG=y
CONFIG_LOG_MODE_MINIMAL=y
CONFIG_THREAD_NAME=y

CONFIG_SERIAL=y
CONFIG_UART_LINE_CTRL=n

CONFIG_ZBUS=y
CONFIG_ZBUS_LOG_LEVEL_DBG=y
CONFIG_ZBUS_CHANNEL_NAME=y
CONFIG_ZBUS_CHANNEL_USER_DATA_SIZE=1
```

## prj_hifive1_revb.conf
```kconfig
CONFIG_LOG=y
CONFIG_LOG_MODE_MINIMAL=y
CONFIG_THREAD_NAME=y

CONFIG_SERIAL=y
CONFIG_UART_LINE_CTRL=n
CONFIG_UART_INTERRUPT_DRIVEN=y
CONFIG_UART_SIFIVE_PORT_1=y
CONFIG_UART_SIFIVE_PORT_1_TXCNT_IRQ=1
CONFIG_UART_SIFIVE_PORT_1_RXCNT_IRQ=1

CONFIG_ZBUS=y
CONFIG_ZBUS_LOG_LEVEL_DBG=y
CONFIG_ZBUS_CHANNEL_NAME=y
CONFIG_ZBUS_CHANNEL_USER_DATA_SIZE=1
```

## prj_native_posix.conf
```kconfig
CONFIG_LOG=y
CONFIG_LOG_MODE_MINIMAL=y
CONFIG_THREAD_NAME=y
CONFIG_SERIAL=y
CONFIG_UART_LINE_CTRL=n
CONFIG_UART_NATIVE_POSIX_PORT_1_ENABLE=y

CONFIG_ZBUS=y
CONFIG_ZBUS_LOG_LEVEL_DBG=y
CONFIG_ZBUS_CHANNEL_NAME=y
CONFIG_ZBUS_CHANNEL_USER_DATA_SIZE=1
```

## prj_native_posix_64.conf
```kconfig
CONFIG_LOG=y
CONFIG_LOG_MODE_MINIMAL=y
CONFIG_THREAD_NAME=y

CONFIG_SERIAL=y
CONFIG_UART_LINE_CTRL=n
CONFIG_UART_NATIVE_POSIX_PORT_1_ENABLE=y

CONFIG_ZBUS=y
CONFIG_ZBUS_LOG_LEVEL_DBG=y
CONFIG_ZBUS_CHANNEL_NAME=y
CONFIG_ZBUS_CHANNEL_USER_DATA_SIZE=1
```

## src/bridge.c
```c
/*
 * Copyright (c) 2022 Rodrigo Peixoto <rodrigopex@gmail.com>
 * SPDX-License-Identifier: Apache-2.0
 */
#include "messages.h"

#include <string.h>

#include <zephyr/device.h>
#include <zephyr/drivers/uart.h>
#include <zephyr/kernel.h>
#include <zephyr/logging/log.h>
#include <zephyr/zbus/zbus.h>
LOG_MODULE_DECLARE(zbus, CONFIG_ZBUS_LOG_LEVEL);

ZBUS_SUBSCRIBER_DEFINE(bridge_sub, 4);

ZBUS_CHAN_DEFINE(finish_chan,	    /* Name */
		 false,		    /* Read only */
		 struct action_msg, /* Message type */

		 NULL,			     /* Validator */
		 ZBUS_OBSERVERS(bridge_sub), /* observers */
		 ZBUS_MSG_INIT(false)	     /* Initial value */
);

const static struct device *bridge_uart = DEVICE_DT_GET(DT_NODELABEL(uart1));

static void bridge_tx_thread(void)
{
	LOG_DBG("Bridge Started");

	struct zbus_channel *chan;

	while (1) {
		if (!zbus_sub_wait(&bridge_sub, &chan, K_FOREVER)) {
			if (!zbus_chan_claim(chan, K_MSEC(500))) {
				bool *user_data = (bool *)zbus_chan_user_data(chan);
				bool generated_by_the_bridge = *user_data;
				*user_data = false;

				zbus_chan_finish(chan);

				/* true here means the package was published by the bridge and must
				 * be discarded
				 */
				if (!generated_by_the_bridge) {
					LOG_DBG("Bridge send %s", zbus_chan_name(chan));

					uart_poll_out(bridge_uart, '$');

					for (int i = 0; i < strlen(zbus_chan_name(chan)); ++i) {
						uart_poll_out(bridge_uart, zbus_chan_name(chan)[i]);
					}

					uart_poll_out(bridge_uart, ',');

					uart_poll_out(bridge_uart, zbus_chan_msg_size(chan));

					for (int i = 0; i < zbus_chan_msg_size(chan); ++i) {
						uart_poll_out(bridge_uart,
							      ((uint8_t *)zbus_chan_msg(chan))[i]);
					}

					uart_poll_out(bridge_uart, '\r');

					uart_poll_out(bridge_uart, '\n');
				}
			}
		}
	}
}

K_THREAD_DEFINE(bridge_thread_tid, 2048, bridge_tx_thread, NULL, NULL, NULL, 1, 0, 500);
```

## src/core.c
```c
/*
 * Copyright (c) 2022 Rodrigo Peixoto <rodrigopex@gmail.com>
 * SPDX-License-Identifier: Apache-2.0
 */
#include "messages.h"

#include <zephyr/logging/log.h>
#include <zephyr/zbus/zbus.h>
LOG_MODULE_DECLARE(zbus, CONFIG_ZBUS_LOG_LEVEL);

ZBUS_CHAN_DECLARE(start_measurement_chan);

ZBUS_CHAN_DEFINE(version_chan,	     /* Name */
		 true,		     /* Read only */
		 struct version_msg, /* Message type */

		 NULL,		       /* Validator */
		 ZBUS_OBSERVERS_EMPTY, /* observers */
		 ZBUS_MSG_INIT(.major = 0, .minor = 1,
			       .build = 1023) /* Initial value major 0, minor 1, build 1023 */
);

static void core_thread(void)
{
	struct action_msg start = {false};

	while (1) {
		LOG_DBG("Core sending start measurement with status %d", start.status);

		start.status = !start.status;
		zbus_chan_pub(&start_measurement_chan, &start, K_MSEC(500));

		k_msleep(1000);
	}
}

K_THREAD_DEFINE(core_thread_id, 1024, core_thread, NULL, NULL, NULL, 3, 0, 0);
```

## src/peripheral.c
```c
/*
 * Copyright (c) 2022 Rodrigo Peixoto <rodrigopex@gmail.com>
 * SPDX-License-Identifier: Apache-2.0
 */
#include "messages.h"

#include <zephyr/logging/log.h>
#include <zephyr/zbus/zbus.h>
LOG_MODULE_DECLARE(zbus, CONFIG_ZBUS_LOG_LEVEL);

ZBUS_SUBSCRIBER_DEFINE(peripheral_sub, 8);

ZBUS_CHAN_DECLARE(sensor_data_chan);

ZBUS_CHAN_DEFINE(sensor_data_chan,	 /* Name */
		 false,			 /* Read only */
		 struct sensor_data_msg, /* Message type */

		 NULL,			     /* Validator */
		 ZBUS_OBSERVERS(bridge_sub), /* observers */
		 ZBUS_MSG_INIT(0)	     /* Initial value {0} */
);

ZBUS_CHAN_DEFINE(start_measurement_chan, /* Name */
		 false,			 /* Read only */
		 struct action_msg,	 /* Message type */

		 NULL,					     /* Validator */
		 ZBUS_OBSERVERS(bridge_sub, peripheral_sub), /* observers */
		 ZBUS_MSG_INIT(false)			     /* Initial value */
);

static void peripheral_thread(void)
{
	struct zbus_channel *chan;
	struct sensor_data_msg sd = {0, 0};

	while (!zbus_sub_wait(&peripheral_sub, &chan, K_FOREVER)) {
		LOG_DBG("Peripheral sending sensor data");

		sd.a += 1;
		sd.b += 10;

		zbus_chan_pub(&sensor_data_chan, &sd, K_MSEC(250));
	}
}

K_THREAD_DEFINE(peripheral_thread_id, 1024, peripheral_thread, NULL, NULL, NULL, 3, 0, 0);
```
