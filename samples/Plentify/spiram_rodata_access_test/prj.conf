## CMakeLists.txt
```
# SPDX-License-Identifier: Apache-2.0

cmake_minimum_required(VERSION 3.20.0)

find_package(Zephyr REQUIRED HINTS $ENV{ZEPHYR_BASE})
project(spiram_rodata_memtest)

# zephyr_sources_ifdef(CONFIG_MEMTEST_INLINE src/spiram_memtest.c)
# zephyr_sources_ifdef(CONFIG_MEMTEST_BSS src/spiram_memtest_bss.c)
# zephyr_sources_ifdef(CONFIG_MEMTEST_HEAP src/spiram_memtest_heap.c)

target_sources(app PRIVATE src/main.c)
```

## Kconfig
```
config VERBOSE
	bool "Verbose output during the tests"


config MEM_INCREASE_STEP
	int "Memory chunks (in bytes) to add each iteration"
	default 1024

config TEST_MEM_SIZE
	int "The allocated size in bss or heap."
	default 32768 if MEMTEST_BSS
	default 65536 if MEMTEST_HEAP
	default 0

config STACK_SIZE
	int "Base stack size (in bytes) for the tests"
	default 16384

config PARALLEL
	bool "Run the tests in parallel. If disabled, all the tests are going to run sequentially."
	default y

source "Kconfig.zephyr"
```

## prj.conf
```kconfig
CONFIG_ESP_SPIRAM=y
# CONFIG_SPIRAM_MODE_OCT=y
CONFIG_ESP32S3_DATA_CACHE_64KB=y
CONFIG_ESP_SPIRAM_HEAP_SIZE=32768
CONFIG_APP_ALLOC_SPIRAM=n
# CONFIG_ESP32_WIFI_NET_ALLOC_SPIRAM=n

CONFIG_POWER=n
CONFIG_POWER_METER_DRIVER=n
CONFIG_ADE9153A=n
CONFIG_SENSOR=n
CONFIG_PM=n
```

## src/main.c
```c
/*
 * Copyright (c) 2012-2014 Wind River Systems, Inc.
 *
 * SPDX-License-Identifier: Apache-2.0
 */

#include <zephyr/kernel.h>
#include <zephyr/kernel/thread_stack.h>

#define APP_THREAD_STACK_SIZE 65536
#define RODATA_ARRAY_SIZE     (16 << 10) // 32768 // 131071

uint32_t rodata_array[RODATA_ARRAY_SIZE] Z_GENERIC_SECTION(.ext_ram.bss);
// = {
// #include "./lookup_table_values.def"
// };

void spiram_memtest_thread(void *ptr1, void *ptr2, void *ptr3)
{
	printk("Memtest SPIRAM: %p\n", rodata_array);
	for (uint32_t i = 18312 /*RODATA_ARRAY_SIZE - 1*/; i >= 0; i -= 1) {
		printk("i = %u\n", i);
		if (rodata_array[i] != i) {
			printk("Error! Test failed for %u, value=%u\n", i, rodata_array[i]);
			break;
		}
	}
	printk("Test ok!\n");

	while (1) {
		k_sleep(K_FOREVER);
	}
}

Z_KERNEL_STACK_DEFINE_IN(my_stack_area, APP_THREAD_STACK_SIZE, Z_GENERIC_SECTION(.ext_ram.bss));
// K_THREAD_STACK_DEFINE(my_stack_area, APP_THREAD_STACK_SIZE);

struct k_thread my_thread_data;

int main(void)
{
	for (uint32_t i = 0; i < RODATA_ARRAY_SIZE; i += 1) {
		// printk("set rodata_array[%d] = ", i);
		rodata_array[i] = i;
		if (rodata_array[i] != i) {
			printk("Could not write to %u, value=%u\n", i, rodata_array[i]);
			break;
		}
		// printk("%d\n", rodata_array[i]);
	}

	printk("Starting SPIRAM memtest rodata_array access on board %s\n", CONFIG_BOARD_TARGET);

	k_tid_t my_tid = k_thread_create(&my_thread_data, my_stack_area,
					 K_THREAD_STACK_SIZEOF(my_stack_area),
					 spiram_memtest_thread, NULL, NULL, NULL, 3, 0, K_NO_WAIT);
	return 0;
}
```
