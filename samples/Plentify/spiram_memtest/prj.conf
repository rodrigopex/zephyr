## CMakeLists.txt
```
# SPDX-License-Identifier: Apache-2.0

cmake_minimum_required(VERSION 3.20.0)

find_package(Zephyr REQUIRED HINTS $ENV{ZEPHYR_BASE})
project(spiram_memtest)

zephyr_sources_ifdef(CONFIG_MEMTEST_INLINE src/spiram_memtest.c)
zephyr_sources_ifdef(CONFIG_MEMTEST_BSS src/spiram_memtest_bss.c)
zephyr_sources_ifdef(CONFIG_MEMTEST_HEAP src/spiram_memtest_heap.c)

target_sources(app PRIVATE src/main.c)
```

## Kconfig
```
config VERBOSE
	bool "Verbose output during the tests"


config MEM_INCREASE_STEP
	int "Memory chunks (in bytes) to add each iteration"
	default 1024

config TEST_MEM_SIZE
	int "The allocated size in bss or heap."
	default 32768 if MEMTEST_BSS
	default 65536 if MEMTEST_HEAP
	default 0

config STACK_SIZE
	int "Base stack size (in bytes) for the tests"
	default 16384

config PARALLEL
	bool "Run the tests in parallel. If disabled, all the tests are going to run sequentially."
	default y

choice
	prompt "The test to be executed"
config MEMTEST_INLINE
	bool "The memory is created inside the thread stack."

config MEMTEST_BSS
	bool "The memory is created outside the thread stack. It will be added in the ext_ram bss.yy"

config MEMTEST_HEAP
	bool "The memory is allocated in the system heap trasnposed to ext_ram."


endchoice

source "Kconfig.zephyr"
```

## prj.conf
```kconfig
CONFIG_ESP_SPIRAM=y
CONFIG_ESP32S3_DATA_CACHE_64KB=y
CONFIG_ESP_SPIRAM_HEAP_SIZE=0
CONFIG_APP_ALLOC_SPIRAM=y
CONFIG_ESP32_WIFI_NET_ALLOC_SPIRAM=n

CONFIG_POWER=n
CONFIG_POWER_METER_DRIVER=n
CONFIG_ADE9153A=n
CONFIG_SENSOR=n
CONFIG_PM=n
```

## prj_heap.conf
```kconfig
CONFIG_ASSERT=y
CONFIG_SHELL=y
CONFIG_SYS_HEAP_RUNTIME_STATS=y

CONFIG_HEAP_MEM_POOL_SIZE=524288
CONFIG_SYSTEM_HEAP_ALLOC_SPIRAM=y
```

## src/main.c
```c
/*
 * Copyright (c) 2012-2014 Wind River Systems, Inc.
 *
 * SPDX-License-Identifier: Apache-2.0
 */

#include <zephyr/kernel.h>

#if defined(CONFIG_MEMTEST_INLINE)
#define TEST_SCOPE "INLINE"
#elif defined(CONFIG_MEMTEST_BSS)
#define TEST_SCOPE "BSS"
#else
#define TEST_SCOPE "HEAP"
#endif

int main(void)
{
	printk("Starting SPIRAM memtest (" TEST_SCOPE ") on board %s\n", CONFIG_BOARD_TARGET);

	return 0;
}
```

## src/memtest.c
```c
#include <zephyr/kernel.h>

int spiram_memtest(volatile uint8_t *mem, size_t mem_size, uint8_t byte)
{
	for (size_t i = 0; i < mem_size; ++i) {
		mem[i] = byte;
	}

	for (size_t i = 0; i < mem_size; ++i) {
		if (mem[i] != byte) {
			return -EBADF;
		}
	}

	return 0;
}

void spiram_memtest_thread(void *ptr1, void *ptr2, void *ptr3)
{
	int ret;
	uint8_t byte = 0xAA;

	printk("Memtest SPIRAM:\n");
	for (size_t mem_size = KB(100); mem_size < MB(1); mem_size += KB(100), ++byte) {
		uint8_t mem[mem_size];
		ret = spiram_memtest(mem, mem_size, byte);
		if (ret != 0) {
			printk("Error! Test failed for %zu\n", mem_size);
		}
		printk("Bytes to write and read %zu -> OK\n", mem_size);
	}
	while (1) {
		k_sleep(K_FOREVER);
	}
}

K_THREAD_DEFINE(memtest_thread_id, KB(1536), spiram_memtest_thread, NULL, NULL, NULL, 9, 0, 0);
```

## src/spiram_memtest.c
```c
#include <zephyr/kernel.h>

int spiram_memtest(volatile uint8_t *mem, size_t mem_size, uint8_t byte)
{
	for (size_t i = 0; i < mem_size; ++i) {
		mem[i] = byte;
	}

	for (size_t i = 0; i < mem_size; ++i) {
		if (mem[i] != byte) {
			return -EBADF;
		}
	}

	return 0;
}

void spiram_memtest_thread(void *ptr1, void *ptr2, void *ptr3)
{
	ARG_UNUSED(ptr2);
	ARG_UNUSED(ptr3);

	uintptr_t thread = (uintptr_t)ptr1;
	int ret;
	uint8_t byte = 0xAA;

	const size_t mem_limit = k_current_get()->stack_info.size - KB(2);

	for (size_t mem_size = CONFIG_MEM_INCREASE_STEP; mem_size < mem_limit;
	     mem_size += CONFIG_MEM_INCREASE_STEP,
		    ++byte IF_ENABLED(CONFIG_PARALLEL, (, k_yield()))) {
		uint8_t mem[mem_size];

		IF_ENABLED(CONFIG_VERBOSE,(
			printk("[%lu] Address: start=%p, end=%p, size=%zu\n", thread,
			       (void *)&mem[0], (void *)&mem[mem_size - 1],
			       (size_t)(&mem[mem_size - 1] - &mem[0]));
		))

		ret = spiram_memtest(mem, mem_size, byte);
		if (ret != 0) {
			printk("[%lu] Error! Test failed for %zu\n", thread, mem_size);
			break;
		}

		IF_ENABLED(CONFIG_VERBOSE,(
			printk("[%lu] Bytes to write and read %zu -> OK\n", thread, mem_size);
	     ))
	}
	if (ret == 0) {
		printk("Thread %lu: OK, memtest for %zuKB\n", thread, mem_limit >> 10);
	}
	return;
}

K_THREAD_DEFINE(memtest_thread_id_01, CONFIG_STACK_SIZE >> 2, spiram_memtest_thread, 1, NULL, NULL,
		9, 0, 0);
K_THREAD_DEFINE(memtest_thread_id_02, CONFIG_STACK_SIZE >> 1, spiram_memtest_thread, 2, NULL, NULL,
		9, 0, 0);
K_THREAD_DEFINE(memtest_thread_id_03, CONFIG_STACK_SIZE, spiram_memtest_thread, 3, NULL, NULL, 9, 0,
		0);
K_THREAD_DEFINE(memtest_thread_id_04, CONFIG_STACK_SIZE, spiram_memtest_thread, 4, NULL, NULL, 9, 0,
		0);
K_THREAD_DEFINE(memtest_thread_id_05, CONFIG_STACK_SIZE, spiram_memtest_thread, 5, NULL, NULL, 9, 0,
		0);
K_THREAD_DEFINE(memtest_thread_id_06, CONFIG_STACK_SIZE, spiram_memtest_thread, 6, NULL, NULL, 9, 0,
		0);
// K_THREAD_DEFINE(memtest_thread_id_07, CONFIG_STACK_SIZE >> 2, spiram_memtest_thread, 7, NULL,
// NULL,
// 9, 0, 0);
// K_THREAD_DEFINE(memtest_thread_id_08, CONFIG_STACK_SIZE << 1,
// spiram_memtest_thread, 5, NULL, NULL, 		9, 0, 0);
```

## src/spiram_memtest_bss.c
```c
#include <zephyr/kernel.h>

int spiram_memtest(volatile uint8_t *mem, size_t mem_size, uint8_t byte)
{
	for (size_t i = 0; i < mem_size; ++i) {
		mem[i] = byte;
	}

	for (size_t i = 0; i < mem_size; ++i) {
		if (mem[i] != byte) {
			return -EBADF;
		}
	}

	return 0;
}

void spiram_memtest_thread(void *thread_id, void *mem_ref, void *ptr3)
{
	ARG_UNUSED(ptr3);

	uintptr_t thread = (uintptr_t)thread_id;
	int ret;
	uint8_t byte = 0xAA;
	uint8_t *mem = mem_ref;

	const size_t mem_limit = CONFIG_BSS_MEM_SIZE;

	for (size_t mem_size = CONFIG_MEM_INCREASE_STEP; mem_size < mem_limit;
	     mem_size += CONFIG_MEM_INCREASE_STEP,
		    ++byte IF_ENABLED(CONFIG_PARALLEL, (, k_yield()))) {

		IF_ENABLED(CONFIG_VERBOSE,(
			printk("[%lu] Address: start=%p, end=%p, size=%zu\n", thread,
			       (void *)&mem[0], (void *)&mem[mem_size - 1],
			       (size_t)(&mem[mem_size - 1] - &mem[0]));
		))

		ret = spiram_memtest(mem, mem_size, byte);
		if (ret != 0) {
			printk("[%lu] Error! Test failed for %zu\n", thread, mem_size);
			break;
		}

		IF_ENABLED(CONFIG_VERBOSE,(
			printk("[%lu] Bytes to write and read %zu -> OK\n", thread, mem_size);
	     ))
	}
	if (ret == 0) {
		printk("Thread %lu: OK, memtest for %zuKB\n", thread, mem_limit >> 10);
	}
	return;
}

uint8_t mem_thread_01[CONFIG_TEST_MEM_SIZE] __attribute__((section(".ext_ram.bss")));
uint8_t mem_thread_02[CONFIG_TEST_MEM_SIZE] __attribute__((section(".ext_ram.bss")));
uint8_t mem_thread_03[CONFIG_TEST_MEM_SIZE] __attribute__((section(".ext_ram.bss")));
uint8_t mem_thread_04[CONFIG_TEST_MEM_SIZE] __attribute__((section(".ext_ram.bss")));
uint8_t mem_thread_05[CONFIG_TEST_MEM_SIZE] __attribute__((section(".ext_ram.bss")));
uint8_t mem_thread_06[CONFIG_TEST_MEM_SIZE] __attribute__((section(".ext_ram.bss")));

K_THREAD_DEFINE(memtest_thread_id_01, CONFIG_STACK_SIZE >> 2, spiram_memtest_thread, 1,
		mem_thread_01, NULL, 9, 0, 0);
K_THREAD_DEFINE(memtest_thread_id_02, CONFIG_STACK_SIZE >> 1, spiram_memtest_thread, 2,
		mem_thread_02, NULL, 9, 0, 0);
K_THREAD_DEFINE(memtest_thread_id_03, CONFIG_STACK_SIZE, spiram_memtest_thread, 3, mem_thread_03,
		NULL, 9, 0, 0);
K_THREAD_DEFINE(memtest_thread_id_04, CONFIG_STACK_SIZE, spiram_memtest_thread, 4, mem_thread_04,
		NULL, 9, 0, 0);
K_THREAD_DEFINE(memtest_thread_id_05, CONFIG_STACK_SIZE, spiram_memtest_thread, 5, mem_thread_05,
		NULL, 9, 0, 0);
K_THREAD_DEFINE(memtest_thread_id_06, CONFIG_STACK_SIZE, spiram_memtest_thread, 6, mem_thread_06,
		NULL, 9, 0, 0);
```

## src/spiram_memtest_heap.c
```c
#include <zephyr/kernel.h>

int spiram_memtest(volatile uint8_t *mem, size_t mem_size, uint8_t byte)
{
	for (size_t i = 0; i < mem_size; ++i) {
		mem[i] = byte;
	}

	for (size_t i = 0; i < mem_size; ++i) {
		if (mem[i] != byte) {
			return -EBADF;
		}
	}

	return 0;
}

void spiram_memtest_thread(void *thread_id, void *ptr2, void *ptr3)
{
	ARG_UNUSED(ptr2);
	ARG_UNUSED(ptr3);

	uintptr_t thread = (uintptr_t)thread_id;
	int ret;
	uint8_t byte = 0xAA;

	uint8_t *mem = k_malloc(CONFIG_TEST_MEM_SIZE);

	__ASSERT(mem != NULL, "Could not malloc the requested size");

	const size_t mem_limit = CONFIG_TEST_MEM_SIZE;
	size_t mem_size = CONFIG_MEM_INCREASE_STEP;
	for (; mem_size < mem_limit; mem_size += CONFIG_MEM_INCREASE_STEP,
				     ++byte IF_ENABLED(CONFIG_PARALLEL, (, k_yield()))) {

		IF_ENABLED(CONFIG_VERBOSE,(
			printk("[%lu] Address: start=%p, end=%p, size=%zu\n", thread,
			       (void *)&mem[0], (void *)&mem[mem_size - 1],
			       (size_t)(&mem[mem_size - 1] - &mem[0]));
		))

		ret = spiram_memtest(mem, mem_size, byte);
		if (ret != 0) {
			printk("[%lu] Error! Test failed for %zu\n", thread, mem_size);
			break;
		}

		IF_ENABLED(CONFIG_VERBOSE,(
			printk("[%lu] Bytes to write and read %zu -> OK\n", thread, mem_size);
	     ))
	}
	if (ret == 0) {
		printk("Thread %lu: OK, memtest for %zuKB\n", thread, mem_size >> 10);
	}
	return;
}

K_THREAD_DEFINE(memtest_thread_id_01, CONFIG_STACK_SIZE >> 2, spiram_memtest_thread, 1, NULL, NULL,
		9, 0, 0);
K_THREAD_DEFINE(memtest_thread_id_02, CONFIG_STACK_SIZE >> 1, spiram_memtest_thread, 2, NULL, NULL,
		9, 0, 0);
K_THREAD_DEFINE(memtest_thread_id_03, CONFIG_STACK_SIZE, spiram_memtest_thread, 3, NULL, NULL, 9, 0,
		0);
K_THREAD_DEFINE(memtest_thread_id_04, CONFIG_STACK_SIZE, spiram_memtest_thread, 4, NULL, NULL, 9, 0,
		0);
K_THREAD_DEFINE(memtest_thread_id_05, CONFIG_STACK_SIZE, spiram_memtest_thread, 5, NULL, NULL, 9, 0,
		0);
K_THREAD_DEFINE(memtest_thread_id_06, CONFIG_STACK_SIZE, spiram_memtest_thread, 6, NULL, NULL, 9, 0,
		0);
```
